## packages/third-party/ota_downloader/Kconfig
```kconfig
# Kconfig file for package ota_downloader
menuconfig LPKG_USING_OTA_DOWNLOADER
    bool "ota_downloader: The firmware downloader which using on RT-Thread OTA component"
    default n

if LPKG_USING_OTA_DOWNLOADER

    config PKG_OTA_DOWNLOADER_PATH
        string
        default "/packages/third-party/ota_downloader"

    config OTA_DOWNLOADER_DEBUG
        bool "Enable OTA downloader debug"
        default n

    config LPKG_USING_HTTP_OTA
        bool "Enable HTTP/HTTPS OTA"
        select LPKG_USING_WEBCLIENT
        select AIC_ENV_INTERFACE
        select AIC_AB_SYSTEM_INTERFACE
        default n
        if LPKG_USING_HTTP_OTA
            config PKG_HTTP_OTA_URL
                string "HTTP OTA Download default URL"
                default "http://192.168.31.22/ota.cpio"
        endif

    config LPKG_USING_YMODEM_OTA
        bool "Enable Ymodem OTA"
        select RT_USING_RYM
        default y

    choice
        prompt "Version"
        default LPKG_USING_OTA_DOWNLOADER_LATEST_VERSION
        help
            Select the package version

        config LPKG_USING_OTA_DOWNLOADER_V100
            bool "v1.0.0"

        config LPKG_USING_OTA_DOWNLOADER_LATEST_VERSION
            bool "latest"
    endchoice

    config PKG_OTA_DOWNLOADER_VER
       string
       default "v1.0.0"    if LPKG_USING_OTA_DOWNLOADER_V100
       default "latest"    if LPKG_USING_OTA_DOWNLOADER_LATEST_VERSION

endif
```

## packages/third-party/ramdisk/Kconfig
```kconfig
# Kconfig file for package ramdisk
menuconfig LPKG_USING_RAMDISK
    bool "ramdisk: A RAM memory block device."
    default n

if LPKG_USING_RAMDISK

    choice
        prompt "RAMDISK type"
        default LPKG_RAMDISK_INIT_DEVICE_NAME

    config LPKG_RAMDISK_TYPE_EMPTY
        bool "Create empty RAMDISK"

    config LPKG_RAMDISK_TYPE_INITDATA
        bool "Create RAMDISK from initial data"
endchoice

if LPKG_RAMDISK_TYPE_EMPTY
    config LPKG_RAMDISK_BLK_SIZE
        int "Ramdisk block size"
        default 512

    config LPKG_RAMDISK_NUM_BLK
        int "Ramdisk number block"
        default 6144
endif

if LPKG_RAMDISK_TYPE_INITDATA
    config LPKG_RAMDISK_INIT_DEVICE_NAME
        string "RAMDISK initial device name"
        default "rodata"
endif

endif
```

## target/d12x/demo68-nand/Kconfig.board
```kconfig
menu "Board options"

#============================================
# Peripheral Devices
#============================================
comment "Peripheral Devices:"

#---------------------------
# cmu device global option
#---------------------------

#---------------------------
# gpio device global option
#---------------------------

source "bsp/artinchip/drv/gpio/Kconfig.dev"

#================================================
# Interface Class
#================================================

comment "Interface Related:"

#---------------------------
# uart device global option
#---------------------------

config AIC_USING_UART0
    bool "Using Uart0"
    default n
    select AIC_UART_DRV

config AIC_USING_UART1
    bool "Using Uart1"
    default n
    select AIC_UART_DRV

config AIC_USING_UART2
    bool "Using Uart2"
    default n
    select AIC_UART_DRV

config AIC_USING_UART3
    bool "Using Uart3"
    default n
    select AIC_UART_DRV

source "bsp/artinchip/drv/uart/Kconfig.dev"

#---------------------------
# i2c device global option
#---------------------------

config AIC_USING_I2C0
    bool "Using I2c0"
    default n
    select AIC_I2C_DRV

config AIC_USING_I2C1
    bool "Using I2c1"
    default n
    select AIC_I2C_DRV

source "bsp/artinchip/drv/i2c/Kconfig.dev"

#---------------------------
# PWM device global option
#---------------------------

config AIC_USING_PWM0
    bool "Using PWM0"
    default n
    select AIC_PWM_DRV

config AIC_USING_PWM1
    bool "Using PWM1"
    default n
    select AIC_PWM_DRV

config AIC_USING_PWM2
    bool "Using PWM2"
    default n
    select AIC_PWM_DRV

config AIC_USING_PWM3
    bool "Using PWM3"
    default n
    select AIC_PWM_DRV

#---------------------------
# CAN device global option
#---------------------------

config AIC_USING_CAN0
    bool "Using CAN0"
    default n
    select AIC_CAN_DRV
    select RT_USING_CAN
    select RT_CAN_USING_HDR

config AIC_USING_CAN1
    bool "Using CAN1"
    default n
    select AIC_CAN_DRV
    select RT_USING_CAN
    select RT_CAN_USING_HDR

#---------------------------
# CIR device global option
#---------------------------

config AIC_USING_CIR
    bool "Using CIR"
    default n
    select AIC_CIR_DRV

source "bsp/artinchip/drv/cir/Kconfig"

#================================================
# Storage Class
#================================================

comment "Storage Related:"

#--------------------------------------------
# qspi device global option
#--------------------------------------------

config AIC_USING_QSPI0
    bool "Using Qspi0"
    default n
    select AIC_QSPI_DRV

config AIC_USING_QSPI1
    bool "Using Qspi1"
    default n
    select AIC_QSPI_DRV

source "bsp/artinchip/drv/qspi/Kconfig.dev"

#---------------------------
# SDMC device global option
#---------------------------

config AIC_USING_SDMC0
    bool "Using SDMC0"
    default n
    select AIC_SDMC_DRV

config AIC_USING_SDMC1
    bool "Using SDMC1"
    default y
    select AIC_SDMC_DRV

source "bsp/artinchip/drv/sdmc/Kconfig"

#================================================
# Analog Class
#================================================

comment "Analog Related:"

#---------------------------
# TSEN device global option
#---------------------------

config AIC_USING_TSEN
    bool "Using TSensor"
    default n
    select AIC_TSEN_DRV

#---------------------------
# GPAI device global option
#---------------------------

config AIC_USING_GPAI
    bool "Using GPAI"
    default n
    select AIC_GPAI_DRV

menu "GPAI options"
    depends on AIC_USING_GPAI

config AIC_USING_GPAI0
    bool "Using GPAI0"
    default n
    select AIC_GPAI_DRV

config AIC_USING_GPAI1
    bool "Using GPAI1"
    default n
    select AIC_GPAI_DRV

config AIC_USING_GPAI2
    bool "Using GPAI2"
    default n
    select AIC_GPAI_DRV

config AIC_USING_GPAI3
    bool "Using GPAI3"
    default n
    select AIC_GPAI_DRV

config AIC_USING_GPAI4
    bool "Using GPAI4"
    default n
    select AIC_GPAI_DRV

config AIC_USING_GPAI5
    bool "Using GPAI5"
    default n
    select AIC_GPAI_DRV

source "bsp/artinchip/drv/gpai/Kconfig.dev"
endmenu

#================================================
# MutiMedia Class
#================================================

comment "MutiMedia Related:"

#--------------------------------------------
# DE device global option
#--------------------------------------------

config AIC_USING_DE
    bool "Using Display Engine (DE)"
    default y
    select AIC_DE_DRV

menu "Display Parameter"
    depends on AIC_DE_DRV
    source "bsp/artinchip/drv/display/Kconfig"
endmenu

#--------------------------------------------
# GE device global option
#--------------------------------------------

config AIC_USING_GE
    bool "Using Graphics Engine (GE)"
    default y
    select AIC_GE_DRV

source "bsp/artinchip/drv/ge/Kconfig"

#--------------------------------------------
# VE device global option
#--------------------------------------------

config AIC_USING_VE
    bool "Using Video Engine (VE)"
    default y
    select AIC_VE_DRV

#---------------------------
# MDI device global option
#---------------------------

config AIC_USING_MDI
    bool "Using MDI"
    default n
    select AIC_MDI_DRV

#---------------------------
# AUDIO device global option
#---------------------------

config AIC_USING_AUDIO
    bool "Using Audio"
    default n
    select AIC_AUDIO_DRV
    select AIC_USING_DMA

source "bsp/artinchip/drv/audio/Kconfig"

#---------------------------
# xxx device global option
#---------------------------


#================================================
# System Class
#================================================

comment "System Related:"

#---------------------------
# DMA device global option
#---------------------------

config AIC_USING_DMA
    bool "Using DMA"
    default n
    select AIC_DMA_DRV

#---------------------------
# WRI device global option
#---------------------------

config AIC_USING_WRI
    bool "Using WRI"
    default n
    select AIC_WRI_DRV

#---------------------------
# WDT device global option
#---------------------------

config AIC_USING_WDT
    bool "Using Watchdog"
    default n
    select AIC_WDT_DRV

#---------------------------
# Mem options
#---------------------------

menu "Mem Options"

# 1. sram region
config AIC_SRAM_SIZE
    hex "SRAM Size"
    default 0x8000

# 1.1 sram cma: section(".sram_cma_data") + sram_cma_heap "MEM_SRAM_CMA"

config AIC_SRAM_CMA_EN
    bool
    default y if AIC_SRAM_SIZE > 0

# 1.2 sram sw: section(".sram_sw_data") + sram_sw_heap 'MEM_SRAM_SW'
config AIC_SRAM_SW_SIZE
    hex "Software size in SRAM"
    range 0 AIC_SRAM_SIZE
    default 0x0

config AIC_SRAM_SW_EN
    bool
    default y if AIC_SRAM_SW_SIZE > 0

# 2. psram region
config AIC_PSRAM_SIZE
    hex "PSRAM size"
    default 0x800000

# 2.1 psram cma: section(".psram_cma_data") + psram_cma_heap ‘MEM_PSRAM_CMA’

config AIC_PSRAM_CMA_EN
    bool
    default y if AIC_PSRAM_SIZE > 0

# 2.2 psram sw: section(".text" + ".data" + ".bss") + psram_sw_heap ‘MEM_DEFAULT’
config AIC_PSRAM_SW_SIZE
    hex "Software size in PSRAM"
    range 0 AIC_PSRAM_SIZE
    default 0x100000

config AIC_INTERRUPTSTACK_SIZE
    int "Interrupt stack size reserve in '.section .bss'"
    range 0 AIC_PSRAM_SW_SIZE
    default 4096

config AIC_XIP
    bool "Enable XIP"
    default n

#-----------------------------
# XIP config parameter
#-----------------------------
menu "XIP parameter"
    depends on AIC_XIP
    config AIC_XIP_FW_OFFSET
    hex "XIP fw start addr"
    default 0x0
endmenu
endmenu

#---------------------------
# Clock options
#---------------------------

menu "Clocks options"

config AIC_CLK_PLL_INT0_FREQ
    int "Clk int0 pll frequence"
    default 396000000

config AIC_CLK_PLL_INT1_FREQ
    int "Clk int1 pll frequence"
    default 588000000

config AIC_CLK_PLL_FRA0_FREQ
    int "Clk fra0 pll frequence"
    default 396000000

config AIC_CLK_PLL_FRA0_SSC_DIS
    bool "Disable fra0 pll spread spectrum"
    default n

config AIC_CLK_PLL_FRA2_FREQ
    int "Clk fra2 pll frequence"
    default 396000000

config AIC_CLK_PLL_FRA2_SSC_DIS
    bool "Disable fra2 pll spread spectrum"
    default n

config AIC_CLK_CPU_FREQ
    int "Clk cpu frequence"
    default 396000000

config AIC_CLK_AXI0_FREQ
    int "Clk axi0 frequence"
    default 200000000

config AIC_CLK_AHB0_FREQ
    int "Clk ahb0 frequence"
    default 200000000

config AIC_CLK_APB0_FREQ
    int "Clk apb0 frequence"
    default 100000000

endmenu

#---------------------------
# PM options
#---------------------------

config AIC_USING_PM
    bool "Using Power Management"
    default n
    select AIC_PM_DRV

source "bsp/artinchip/drv/pm/Kconfig"

#================================================
# Security Class
#================================================

comment "Security Related:"

#--------------------------------------------
# spienc device global option
#--------------------------------------------

config AIC_USING_SPIENC
    bool "Using Spienc"
    default n
    select AIC_QSPI_DRV
    select AIC_SPIENC_DRV

source "bsp/artinchip/drv/spienc/Kconfig"

#---------------------------
# efuse/sid device global option
#---------------------------

config AIC_USING_SID
    bool "Using Efuse/SID"
    default n
    select AIC_SID_DRV

source "bsp/artinchip/drv/efuse/Kconfig.dev"

#---------------------------
# dce device global option
#---------------------------

config AIC_USING_DCE
    bool "Using Data Check Engine"
    default n
    select AIC_DCE_DRV

#source "bsp/artinchip/drv/dce/Kconfig"

#---------------------------
# syscfg global option
#---------------------------

config AIC_USING_SYSCFG
    bool "Using Syscfg"
    default y

source "bsp/artinchip/drv/syscfg/Kconfig.dev"

#---------------------------
# mtop device global option
#---------------------------

config AIC_USING_MTOP
    bool "Using MTOP"
    default n
    select AIC_MTOP_DRV

endmenu
```
