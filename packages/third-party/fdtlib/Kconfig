## target/d21x/demo128-mmc/Kconfig.board
```kconfig
menu "Board options"

#---------------------------
# cmu device global option
#---------------------------

#---------------------------
# gpio device global option
#---------------------------

source "bsp/artinchip/drv/gpio/Kconfig.dev"

#================================================
# Interface Class
#================================================

comment "Interface Related:"

#---------------------------
# uart device global option
#---------------------------

config AIC_USING_UART0
    bool "Using Uart0"
    default n
    select AIC_UART_DRV

config AIC_USING_UART1
    bool "Using Uart1"
    default n
    select AIC_UART_DRV

config AIC_USING_UART2
    bool "Using Uart2"
    default n
    select AIC_UART_DRV

config AIC_USING_UART3
    bool "Using Uart3"
    default n
    select AIC_UART_DRV

config AIC_USING_UART4
    bool "Using Uart4"
    default n
    select AIC_UART_DRV

config AIC_USING_UART5
    bool "Using Uart5"
    default n
    select AIC_UART_DRV

config AIC_USING_UART6
    bool "Using Uart6"
    default n
    select AIC_UART_DRV

config AIC_USING_UART7
    bool "Using Uart7"
    default n
    select AIC_UART_DRV

source "bsp/artinchip/drv/uart/Kconfig.dev"

#---------------------------
# i2c device global option
#---------------------------

config AIC_USING_I2C0
    bool "Using I2c0"
    default n
    select AIC_I2C_DRV

config AIC_USING_I2C1
    bool "Using I2c1"
    default n
    select AIC_I2C_DRV

config AIC_USING_I2C2
    bool "Using I2c2"
    default n
    select AIC_I2C_DRV

config AIC_USING_I2C3
    bool "Using I2c3"
    default n
    select AIC_I2C_DRV

source "bsp/artinchip/drv/i2c/Kconfig.dev"

#---------------------------
# PWM device global option
#---------------------------

config AIC_USING_PWM0
    bool "Using PWM0"
    default n
    select AIC_PWM_DRV

config AIC_USING_PWM1
    bool "Using PWM1"
    default n
    select AIC_PWM_DRV

config AIC_USING_PWM2
    bool "Using PWM2"
    default n
    select AIC_PWM_DRV

config AIC_USING_PWM3
    bool "Using PWM3"
    default n
    select AIC_PWM_DRV

#---------------------------
# HRTimer device global option
#---------------------------

config AIC_USING_HRTIMER0
    bool "Using HRTimer0"
    default n
    select AIC_HRTIMER_DRV

config AIC_USING_HRTIMER1
    bool "Using HRTimer1"
    default n
    select AIC_HRTIMER_DRV

config AIC_USING_HRTIMER2
    bool "Using HRTimer2"
    default n
    select AIC_HRTIMER_DRV

#---------------------------
# CAN device global option
#---------------------------

config AIC_USING_CAN0
    bool "Using CAN0"
    default n
    select AIC_CAN_DRV
    select RT_USING_CAN
    select RT_CAN_USING_HDR

config AIC_USING_CAN1
    bool "Using CAN1"
    default n
    select AIC_CAN_DRV
    select RT_USING_CAN
    select RT_CAN_USING_HDR

#---------------------------
# CIR device global option
#---------------------------

config AIC_USING_CIR
    bool "Using CIR"
    default n
    select AIC_CIR_DRV

source "bsp/artinchip/drv/cir/Kconfig"

#---------------------------
# usb device global option
#---------------------------

config AIC_USING_USB0
    bool "Using Usb0"
    default n

if AIC_USING_USB0
    choice
        prompt "Select Usb0 mode"
        default AIC_USING_USB0_DEVICE
        config AIC_USING_USB0_HOST
            bool "Host"
            select AIC_USB_HOST_EHCI_DRV
        config AIC_USING_USB0_DEVICE
            bool "Device"
            select AIC_USB_DEVICE_DRV
        config AIC_USING_USB0_OTG
            bool "OTG"
            select AIC_USB_DEVICE_DRV
            select AIC_USB_HOST_EHCI_DRV
    endchoice
endif

if !AIC_USING_USB0_HOST
    config AIC_USING_USB1_HOST
        bool "Using Usb1 (Host)"
        default n
        select AIC_USB_HOST_EHCI_DRV
endif

config AIC_USING_USB1
    bool "Using Usb1"
    default n

if AIC_USING_USB1
    choice
        prompt "Select Usb1 mode"
        default AIC_USING_USB1_HOST
        config AIC_USING_USB1_HOST
            bool "Host"
            select AIC_USB_HOST_EHCI_DRV
    endchoice
endif

#---------------------------
# gmac device global option
#---------------------------

config AIC_USING_GMAC0
    bool "Using Gmac0"
    default n
    select AIC_GMAC_DRV

source "packages/third-party/lwip/contrib/ports/drv/aic/Kconfig.dev"

#================================================
# Storage Class
#================================================

comment "Storage Related:"

#--------------------------------------------
# qspi device global option
#--------------------------------------------

config AIC_USING_QSPI0
    bool "Using Qspi0"
    default n
    select AIC_QSPI_DRV

config AIC_USING_QSPI1
    bool "Using Qspi1"
    default n
    select AIC_QSPI_DRV

config AIC_USING_QSPI2
    bool "Using Qspi2"
    default n
    select AIC_QSPI_DRV

config AIC_USING_QSPI3
    bool "Using Qspi3"
    default n
    select AIC_QSPI_DRV

source "bsp/artinchip/drv/qspi/Kconfig.dev"

#---------------------------
# SDMC device global option
#---------------------------

config AIC_USING_SDMC0
    bool "Using SDMC0"
    default n
    select AIC_SDMC_DRV

config AIC_USING_SDMC1
    bool "Using SDMC1"
    default y
    select AIC_SDMC_DRV

config AIC_USING_SDMC2
    bool "Using SDMC2"
    default n
    select AIC_SDMC_DRV

source "bsp/artinchip/drv/sdmc/Kconfig"

#---------------------------
# WLAN device global option
#---------------------------
comment "WLAN Related:"

menuconfig AIC_WIRELESS_LAN
        bool "Using Wireless Lan"
        default n

source "bsp/peripheral/wireless/Kconfig"

#================================================
# Analog Class
#================================================

comment "Analog Related:"

#---------------------------
# TSEN device global option
#---------------------------

config AIC_USING_TSEN
    bool "Using TSensor"
    default n
    select AIC_TSEN_DRV

#---------------------------
# GPAI device global option
#---------------------------

config AIC_USING_GPAI
    bool "Using GPAI"
    default n
    select AIC_GPAI_DRV

menu "GPAI options"
    depends on AIC_USING_GPAI

config AIC_USING_GPAI0
    bool "Using GPAI0"
    default n
    select AIC_GPAI_DRV

config AIC_USING_GPAI1
    bool "Using GPAI1"
    default n
    select AIC_GPAI_DRV

config AIC_USING_GPAI2
    bool "Using GPAI2"
    default n
    select AIC_GPAI_DRV

config AIC_USING_GPAI3
    bool "Using GPAI3"
    default n
    select AIC_GPAI_DRV

config AIC_USING_GPAI4
    bool "Using GPAI4"
    default n
    select AIC_GPAI_DRV

config AIC_USING_GPAI5
    bool "Using GPAI5"
    default n
    select AIC_GPAI_DRV

config AIC_USING_GPAI6
    bool "Using GPAI6"
    default n
    select AIC_GPAI_DRV

config AIC_USING_GPAI7
    bool "Using GPAI7"
    default n
    select AIC_GPAI_DRV

source "bsp/artinchip/drv/gpai/Kconfig.dev"
endmenu

#================================================
# MutiMedia Class
#================================================

comment "MutiMedia Related:"

#--------------------------------------------
# DE device global option
#--------------------------------------------

config AIC_USING_DE
    bool "Using Display Engine (DE)"
    default y
    select AIC_DE_DRV

menu "Display Parameter"
    depends on AIC_DE_DRV
    source "bsp/artinchip/drv/display/Kconfig"
endmenu

#--------------------------------------------
# GE device global option
#--------------------------------------------

config AIC_USING_GE
    bool "Using Graphics Engine (GE)"
    default y
    select AIC_GE_DRV

source "bsp/artinchip/drv/ge/Kconfig"

#--------------------------------------------
# VE device global option
#--------------------------------------------

config AIC_USING_VE
    bool "Using Video Engine (VE)"
    default y
    select AIC_VE_DRV

#---------------------------
# DVP device global option
#---------------------------

config AIC_USING_DVP
    bool "Using DVP"
    default n
    select AIC_DVP_DRV

#--------------------------------------------
# Camera driver global option
#--------------------------------------------

menu "Camera Support"
source "bsp/peripheral/camera/Kconfig"
endmenu

#---------------------------
# I2S global option
#---------------------------

config AIC_USING_I2S0
    bool "Using I2S0"
    default n
    select AIC_I2S_DRV

config AIC_USING_I2S1
    bool "Using I2S1"
    default n
    select AIC_I2S_DRV

#---------------------------
# AUDIO device global option
#---------------------------

config AIC_USING_AUDIO
    bool "Using Audio"
    default n
    select AIC_AUDIO_DRV

source "bsp/artinchip/drv/audio/Kconfig"

#---------------------------
# xxx device global option
#---------------------------


#================================================
# System Class
#================================================

comment "System Related:"

#---------------------------
# DMA device global option
#---------------------------

config AIC_USING_DMA
    bool "Using DMA"
    default n
    select AIC_DMA_DRV

#---------------------------
# WRI device global option
#---------------------------

config AIC_USING_WRI
    bool "Using WRI"
    default n
    select AIC_WRI_DRV

#---------------------------
# RTC device global option
#---------------------------

config AIC_USING_RTC
    bool "Using RTC"
    default n
    select AIC_RTC_DRV

source "bsp/artinchip/drv/rtc/Kconfig"

#---------------------------
# WDT device global option
#---------------------------

config AIC_USING_WDT
    bool "Using Watchdog"
    default n
    select AIC_WDT_DRV

#---------------------------
# Mem options
#---------------------------

menu "Mem Options"

# 1. dram region
config AIC_DRAM_TOTAL_SIZE
    hex "DRAM Total Size"
    default 0x8000000

config AIC_INTERRUPTSTACK_SIZE
    int "Interrupt stack size reserve in '.section .bss'"
    range 0 AIC_DRAM_TOTAL_SIZE
    default 4096

config AIC_DRAM_CMA_SIZE
    hex "CMA mem size"
    range 0 AIC_DRAM_TOTAL_SIZE
    default 0x0

config AIC_DRAM_CMA_EN
    bool
    default y if AIC_DRAM_CMA_SIZE > 0

endmenu

#---------------------------
# Clock options
#---------------------------

menu "Clocks Options"
config AIC_CLK_PLL_INT0_FREQ
    int "Clk int0 pll frequence"
    default 600000000

config AIC_CLK_PLL_INT1_FREQ
    int "Clk int1 pll frequence"
    default 1200000000

#config AIC_CLK_PLL_FRA0_FREQ
#    int "Clk fra0 pll frequence"
#    default 0
#
#config AIC_CLK_PLL_FRA0_SSC_DIS
#    bool "Disable fra0 pll spread spectrum"
#    default n

config AIC_CLK_PLL_FRA1_FREQ
    int "Clk fra1 pll frequence"
    default 491520000

config AIC_CLK_PLL_FRA2_FREQ
    int "Clk fra2 pll frequence"
    default 840000000

config AIC_CLK_PLL_FRA2_SSC_DIS
    bool "Disable fra2 pll spread spectrum"
    default n

config AIC_CLK_CPU_FREQ
    int "Clk cpu frequence"
    default 600000000

config AIC_CLK_AXI0_FREQ
    int "Clk axi0 frequence"
    default 240000000

config AIC_CLK_AHB0_FREQ
    int "Clk ahb0 frequence"
    default 240000000

config AIC_CLK_APB0_FREQ
    int "Clk apb0 frequence"
    default 100000000

config AIC_USING_CLK_OUT0
    bool "Enable CLK_OUT0"
    default n

config AIC_USING_CLK_OUT1
    bool "Enable CLK_OUT1"
    default n

config AIC_USING_CLK_OUT2
    bool "Enable CLK_OUT2"
    default n

config AIC_USING_CLK_OUT3
    bool "Enable CLK_OUT3"
    default n
endmenu

#---------------------------
# PM options
#---------------------------

config AIC_USING_PM
    bool "Using Power Management"
    default n
    select AIC_PM_DRV

source "bsp/artinchip/drv/pm/Kconfig"

#================================================
# Security Class
#================================================

comment "Security Related:"

#--------------------------------------------
# spienc device global option
#--------------------------------------------

config AIC_USING_SPIENC
    bool "Using Spienc"
    default n
    select AIC_QSPI_DRV
    select AIC_SPIENC_DRV

source "bsp/artinchip/drv/spienc/Kconfig"

#---------------------------
# efuse/sid device global option
#---------------------------

config AIC_USING_SID
    bool "Using Efuse/SID"
    default n
    select AIC_SID_DRV

source "bsp/artinchip/drv/efuse/Kconfig.dev"

#---------------------------
# ce device global option
#---------------------------

config AIC_USING_CE
    bool "Using Crypto Engine"
    default n
    select AIC_CE_DRV
    select RT_USING_HWCRYPTO

source "bsp/artinchip/drv/ce/Kconfig"

#---------------------------
# mtop device global option
#---------------------------

config AIC_USING_MTOP
    bool "Using MTOP"
    default n
    select AIC_MTOP_DRV

#---------------------------
# PSADC device global option
#---------------------------

config AIC_USING_PSADC0
    bool "Using PSADC0"
    default n
    select AIC_PSADC_DRV

config AIC_USING_PSADC1
    bool "Using PSADC1"
    default n
    select AIC_PSADC_DRV

config AIC_USING_PSADC2
    bool "Using PSADC2"
    default n
    select AIC_PSADC_DRV

config AIC_USING_PSADC3
    bool "Using PSADC3"
    default n
    select AIC_PSADC_DRV

config AIC_USING_PSADC4
    bool "Using PSADC4"
    default n
    select AIC_PSADC_DRV

config AIC_USING_PSADC5
    bool "Using PSADC5"
    default n
    select AIC_PSADC_DRV

config AIC_USING_PSADC6
    bool "Using PSADC6"
    default n
    select AIC_PSADC_DRV

config AIC_USING_PSADC7
    bool "Using PSADC7"
    default n
    select AIC_PSADC_DRV

config AIC_USING_PSADC8
    bool "Using PSADC8"
    default n
    select AIC_PSADC_DRV

config AIC_USING_PSADC9
    bool "Using PSADC9"
    default n
    select AIC_PSADC_DRV

config AIC_USING_PSADC10
    bool "Using PSADC10"
    default n
    select AIC_PSADC_DRV

config AIC_USING_PSADC11
    bool "Using PSADC11"
    default n
    select AIC_PSADC_DRV

endmenu
```
