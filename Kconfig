## bsp/Kconfig
```kconfig
menu "Drivers options"

#--------------------------------------------
# baremetal driver
#--------------------------------------------

if DRIVER_BARE_DRV_EN
    menu "AIC Bare Driver"

    config AIC_MTD_BARE_DRV
        bool "Enable AIC MTD Bare Driver"
        depends on AIC_SPINAND_DRV || AIC_SPINOR_DRV
        default n

    config AIC_CONSOLE_BARE_DRV
        bool "Enable AIC Tiny Console Bare Driver"
        depends on AIC_UART_DRV
        default n

    if AIC_CONSOLE_BARE_DRV
        config AIC_CONSOLE_SYSNAME
            string "AIC Tiny Console Sysname"
            default "tinySPL"
    endif

    config AIC_PRINTF_BARE_DRV
        bool "Enable Tiny Printf Bare Driver"
        depends on AIC_UART_DRV
        default n

    choice
        prompt "Select Heap Type"
        default AIC_USING_UMM_HEAP if AIC_BOOTLOADER
        default AIC_USING_TLSF_HEAP if ! AIC_BOOTLOADER

        config AIC_USING_TLSF_HEAP
            bool "tlsf"
            select TLSF_MEM_HEAP
        config AIC_USING_UMM_HEAP
            bool "umm"
            select AIC_UMM_HEAP_BARE_DRV
    endchoice

    config AIC_UMM_HEAP_BARE_DRV
        bool "Enable Umm Heap Bare Driver"
        default n

    config TLSF_MEM_HEAP
        bool "Enable Tlsf Heap Bare Driver"
        default n

    endmenu

endif

#--------------------------------------------
# modules driver
#--------------------------------------------

source "bsp/artinchip/drv/gpio/Kconfig.drv"
source "bsp/artinchip/drv/uart/Kconfig.drv"
source "bsp/artinchip/drv/qspi/Kconfig.drv"
source "bsp/artinchip/drv/i2c/Kconfig.drv"
source "bsp/artinchip/drv/spinor/Kconfig.drv"
source "bsp/artinchip/drv/spinand/Kconfig.drv"

#--------------------------------------------
# Peripheral driver
#--------------------------------------------

menu "Peripheral"
source "bsp/peripheral/Kconfig"
endmenu

#--------------------------------------------
# Driver debug option
#--------------------------------------------

menu "Drivers debug"

choice
    prompt "Global log level"
    depends on !RT_USING_ULOG
    default AIC_LOG_LEVEL_WARN

config AIC_LOG_LEVEL_NONE
    bool "none"

config AIC_LOG_LEVEL_ERR
    bool "error"

config AIC_LOG_LEVEL_WARN
    bool "warn"

config AIC_LOG_LEVEL_INFO
    bool "info"

config AIC_LOG_LEVEL_DEBUG
    bool "debug"

endchoice

config AIC_LOG_LEVEL
    int
    default 0 if AIC_LOG_LEVEL_NONE
    default 3 if AIC_LOG_LEVEL_ERR
    default 4 if AIC_LOG_LEVEL_WARN
    default 6 if AIC_LOG_LEVEL_INFO
    default 7 if AIC_LOG_LEVEL_DEBUG

config AIC_CMU_DRV_DEBUG
    bool "Enable CMU driver debug"
    default n
    depends on AIC_CMU_DRV

config AIC_GPIO_DRV_DEBUG
    bool "Enable GPIO driver debug"
    default n
    depends on AIC_GPIO_DRV

config AIC_DMA_DRV_DEBUG
    bool "Enable DMA driver debug"
    default n
    depends on AIC_DMA_DRV

config AIC_UART_DRV_DEBUG
    bool "Enable UART driver debug"
    default n
    depends on AIC_UART_DRV

config AIC_I2C_DRV_DEBUG
    bool "Enable I2C driver debug"
    default n
    depends on AIC_I2C_DRV

config AIC_RTC_DRV_DEBUG
    bool "Enable RTC driver debug"
    default n
    depends on AIC_RTC_DRV

config AIC_QSPI_DRV_DEBUG
    bool "Enable QSPI driver debug"
    default n
    depends on AIC_QSPI_DRV

config AIC_SPINAND_DRV_DEBUG
    bool "Enable SPINAND driver debug"
    default n
    depends on AIC_SPINAND_DRV

config AIC_SPINOR_SFUD_DEBUG
    bool "Enable SPINOR SFUD debug"
    default n
    depends on LPKG_USING_SFUD

config AIC_FB_DRV_DEBUG
    bool "Enable Display driver debug"
    default n
    depends on AIC_DISPLAY_DRV

config AIC_DISP_MIPI_DBI_DEBUG
    bool "Enable MIPI-DBI driver debug"
    default n
    depends on AIC_DISPLAY_DRV && AIC_DISP_MIPI_DBI

endmenu

menu "Drivers examples"

config AIC_CMU_DRV_TEST
    bool "Enable CMU driver test command"
    default n
    depends on AIC_CMU_DRV

config AIC_GPIO_DRV_TEST
    bool "Enable GPIO driver test command"
    default n
    depends on AIC_GPIO_DRV

config AIC_DMA_DRV_TEST
    bool "Enable DMA driver test command"
    default n
    depends on AIC_DMA_DRV

config AIC_UART_DRV_TEST
    bool "Enable UART driver test command"
    default n
    depends on AIC_UART_DRV

config AIC_RTC_DRV_TEST
    bool "Enable RTC driver test command"
    default n
    depends on AIC_RTC_DRV

config AIC_HRTIMER_DRV_TEST
    bool "Enable HRTimer driver test command"
    default n
    depends on AIC_HRTIMER_DRV

config AIC_GPTIMER_DRV_TEST
    bool "Enable GPTimer driver test command"
    default n
    depends on AIC_GPTIMER_DRV

config AIC_QSPI_DRV_TEST
    bool "Enable QSPI driver test command"
    default n
    depends on AIC_QSPI_DRV

config AIC_SPINOR_DRV_TEST
    bool "Enable SPI NOR driver test command"
    default n
    depends on AIC_SPINOR_DRV

config AIC_SPINAND_DRV_TEST
    bool "Enable SPI NAND driver test command"
    default n
    depends on AIC_SPINAND_DRV

config AIC_SDMC_DRV_TEST
    bool "Enable SDMC driver test command"
    default n
    depends on AIC_SDMC_DRV

config AIC_MTD_BARE_TEST
    bool "Enable MTD driver test command"
    default n
    depends on AIC_MTD_BARE_DRV

config AIC_MMC_BARE_TEST
    bool "Enable MMC driver test command"
    default n
    depends on AIC_MMC_BARE_DRV

config AIC_FILE_CRC32_TEST
    bool "Enable file CRC32 test command"
    default n
    select RT_USING_LEGACY

config AIC_MTD_LOAD_FILE_TEST
    bool "Enable load mtd data to a file"
    default n
    select RT_USING_LEGACY

config AIC_DISPLAY_TEST
    bool "Enable Display driver test command"
    default n
    depends on AIC_DISPLAY_DRV

config AIC_VE_TEST
    bool "Enable VE driver test command"
    default n
    depends on AIC_VE_DRV

config AIC_MTOP_DRV_TEST
    bool "Enable mtop driver test command"
    default y
    depends on AIC_MTOP_DRV

config AIC_CAN_DRV_TEST
    bool "Enable CAN driver test command"
    default n
    depends on AIC_CAN_DRV

config AIC_CIR_DRV_TEST
    bool "Enable CIR driver test command"
    default n
    depends on AIC_CIR_DRV

config AIC_AUDIO_DRV_TEST
    bool "Enable audio driver test command"
    default n
    depends on AIC_AUDIO_DRV
    select RT_USING_LEGACY

config AIC_I2S_DRV_TEST
    bool "Enable i2s driver test command"
    default n
    depends on AIC_I2S_DRV
    select RT_USING_LEGACY

config AIC_I2C_DRV_TEST
    bool "Enable i2c driver test command"
    default n
    depends on AIC_I2C_DRV

config AIC_DVP_TEST
    bool "Enable DVP driver test command"
    default n
    depends on AIC_DVP_DRV

config AIC_TP_DRV_TEST
    bool "Enable touch panel driver test command"
    default n
    depends on AIC_TOUCH_PANEL_GT911 || AIC_TOUCH_PANEL_FT7411 || AIC_TOUCH_PANEL_GSL1680

config AIC_WDT_DRV_TEST
    bool "Enable WDT driver test command"
    default n
    depends on AIC_WDT_DRV

config AIC_GPAI_TEST
    bool "Enable GPAI driver test command"
    default n
    depends on AIC_GPAI_DRV

config AIC_TSEN_TEST
    bool "Enable TSEN driver test command"
    default n
    depends on AIC_TSEN_DRV

config AIC_PSADC_TEST
    bool "Enable PSADC driver test command"
    default n
    depends on AIC_PSADC_DRV

config AIC_ZLIB_TEST
    bool "Enable ZLIB test command"
    default n
    depends on AIC_VE_DRV

config AIC_RTP_TEST
    bool "Enable RTP driver test command"
    default n
    depends on AIC_RTP_DRV

config AIC_PWM_TEST
    bool "Enable PWM driver test command"
    default n
    depends on AIC_PWM_DRV

config AIC_CAP_DRV_TEST
    bool "Enable CAP driver test command"
    default n
    depends on AIC_CAP_DRV

config AIC_ADCIM_DM_TEST
    bool "Enable ADCIM DM test command"
    default n
    depends on AIC_ADCIM_DM_DRV

if LPKG_USING_LWIP

    menu "LwIP examples"

    config AIC_MQTT_LWIP_TEST
        bool "Enable MQTT protocol test command"
        default n
        depends on LPKG_LWIP_USING_MQTT

    config AIC_IPERF_LWIP_TEST
        bool "Enable iperf test command"
        default n

    endmenu

endif

config AIC_CE_DRV_TEST
    bool "Enable CE driver test command"
    default n
    depends on AIC_CE_DRV

config AIC_SID_BARE_TEST
    bool "Enable SID driver test command"
    default n
    depends on AIC_SID_DRV

config AIC_DM_LIB_TEST
    bool "Enable DM Lib test command"
    default n
    depends on RT_USING_MODULE

endmenu
endmenu
```

## bsp/artinchip/drv/audio/Kconfig
```kconfig
#-----------------------------
# devices local parameter
#-----------------------------

menu "Audio Parameter"
    depends on AIC_USING_AUDIO

    config AIC_AUDIO_PLAYBACK
        bool "Using Playback"
        default y

    config AIC_AUDIO_PA_ENABLE_GPIO
    string "PA enable pin"
    default "PA.7"
    depends on AIC_AUDIO_PLAYBACK

    if AIC_AUDIO_PLAYBACK
        choice
            prompt "Select PA enable level"
            default AIC_AUDIO_EN_PIN_HIGH

            config  AIC_AUDIO_EN_PIN_HIGH
                bool "high level Active"

            config  AIC_AUDIO_EN_PIN_LOW
                bool "low level Active"
        endchoice

        choice
            prompt "Select SPK channel"
            default AIC_AUDIO_SPK_0_1

            config AIC_AUDIO_SPK_0
                bool "Using SPK0"

            config AIC_AUDIO_SPK_1
                bool "Using SPK1"

            config AIC_AUDIO_SPK_0_1
                bool "Using SPK0 and SPK1"
        endchoice

        if AIC_AUDIO_SPK_0_1
        choice
            prompt "Select SPK output mode"
            default AIC_AUDIO_SPK_OUTPUT_SINGLE

            config AIC_AUDIO_SPK_OUTPUT_SINGLE
                bool "single output"

            config AIC_AUDIO_SPK0_OUTPUT_DIFFERENTIAL
                bool "SPK0 differential output"

            config AIC_AUDIO_SPK1_OUTPUT_DIFFERENTIAL
                bool "SPK1 differential output"
        endchoice
        endif
    endif

    config AIC_AUDIO_DMIC
        bool "Using DMIC"
        default y

    if AIC_AUDIO_DRV_V10
        config AIC_AUDIO_AMIC
            bool "Using AMIC"
            default n
    endif

endmenu
```

## bsp/artinchip/drv/cir/Kconfig
```kconfig
#-----------------------------
# devices local parameter
#-----------------------------

menu "CIR protocol select"
    depends on AIC_USING_CIR

    config AIC_CIR_NEC
        bool "NEC protocol"
        default y

    config AIC_CIR_RC5
        bool "RC5 protocol"
endmenu
```

## bsp/artinchip/drv/display/Kconfig
```kconfig
config AIC_DISPLAY_DRV
    bool "Display Support"
    default y
    depends on AIC_DE_DRV

config AIC_DISP_DE_DRV
    bool
    default y
    depends on AIC_DISPLAY_DRV && AIC_DE_DRV

config AIC_DISP_RGB_DRV
    bool
    default n
    depends on AIC_DE_DRV

config AIC_DISP_LVDS_DRV
    bool
    default n
    depends on AIC_DE_DRV

config AIC_DISP_MIPI_DSI_DRV
    bool
    default n
    depends on AIC_DE_DRV

choice
    prompt "select Display interface"
    default AIC_DISP_RGB
    depends on AIC_DISPLAY_DRV

config AIC_DISP_RGB
    bool "Display RGB interface"
    select AIC_DISP_RGB_DRV
    depends on AIC_DE_DRV_V10 || AIC_DE_DRV_V11 || AIC_DE_DRV_V12

config AIC_DISP_LVDS
    bool "Display LVDS interface"
    select AIC_DISP_LVDS_DRV
    depends on AIC_DE_DRV_V10 || AIC_DE_DRV_V11

config AIC_DISP_MIPI_DSI
    bool "Display MIPI-DSI interface"
    select AIC_DISP_MIPI_DSI_DRV
    depends on AIC_DE_DRV_V10 || AIC_DE_DRV_V11

config AIC_DISP_MIPI_DBI
    bool "Display MIPI-DBI interface"
    select AIC_DISP_MIPI_DBI_DRV
    depends on AIC_DE_DRV_V10 || AIC_DE_DRV_V11 || AIC_DE_DRV_V12
endchoice

config AIC_DI_TYPE
    int
    default 1 if AIC_DISP_RGB
    default 2 if AIC_DISP_LVDS
    default 3 if AIC_DISP_MIPI_DSI
    default 4 if AIC_DISP_MIPI_DBI

if AIC_DISP_LVDS
source "bsp/artinchip/drv/display/Kconfig.lvds"
endif

if AIC_DISP_RGB
source "bsp/artinchip/drv/display/Kconfig.rgb"
endif

choice
    prompt "select framebuffer format"
    default AICFB_ARGB8888
    depends on AIC_DISPLAY_DRV

config AICFB_ARGB8888
    bool "argb8888"

config AICFB_ABGR8888
    bool "abgr8888"

config AICFB_XRGB8888
    bool "xrgb8888"

config AICFB_RGB888
    bool "rgb888"

config AICFB_RGB565
    bool "rgb565"

config AICFB_ARGB1555
    bool "argb1555"
endchoice

config AICFB_FORMAT
    hex
    default 0x00  if AICFB_ARGB8888
    default 0x01  if AICFB_ABGR8888
    default 0x04  if AICFB_XRGB8888
    default 0x08  if AICFB_RGB888
    default 0x0e  if AICFB_RGB565
    default 0x0a  if AICFB_ARGB1555

config AIC_PAN_DISPLAY
    bool "Support double framebuffer"
    default n
    depends on AIC_DISPLAY_DRV

config AIC_DISP_COLOR_BLOCK
    bool "Display color block"
    default y
    depends on AIC_DISPLAY_DRV

config AIC_DISPLAY_DITHER
    bool "Enable Display Dither"
    default n
    depends on AIC_LVDS_JEIDA_18BIT || AIC_PRGB_18BIT_LD || \
               AIC_PRGB_18BIT_HD    || AIC_PRGB_16BIT_LD || \
               AIC_PRGB_16BIT_HD
choice
    prompt "framebuffer rotation degree"
    default AICFB_ROTATE_0
    depends on AIC_DISPLAY_DRV

config AICFB_ROTATE_0
    bool "0"

config AICFB_ROTATE_90
    bool "90"

config AICFB_ROTATE_180
    bool "180"

config AICFB_ROTATE_270
    bool "270"
endchoice

config AIC_FB_ROTATE_EN
    bool
    default y
    depends on AICFB_ROTATE_90 || AICFB_ROTATE_180 || AICFB_ROTATE_270

config AIC_FB_ROTATE_DEGREE
    int
    default 0 if AICFB_ROTATE_0
    default 90 if AICFB_ROTATE_90
    default 180 if AICFB_ROTATE_180
    default 270 if AICFB_ROTATE_270

choice
    prompt "select Output depth"
    default AIC_OUTPUT_DEPTH_16
    depends on AIC_DISPLAY_DITHER

config AIC_OUTPUT_DEPTH_16
    bool "Dither rgb565 Output depth 16"

config AIC_OUTPUT_DEPTH_18
    bool "Dither rgb666 Output depth 18"
endchoice

config AIC_DISP_OUTPUT_DEPTH
    int
    default 1 if AIC_OUTPUT_DEPTH_16
    default 2 if AIC_OUTPUT_DEPTH_18

if AIC_DISPLAY_DRV
source "bsp/artinchip/drv/display/panel/Kconfig"
endif

choice
    prompt "panel backlight control"
    default AIC_GPIO_BACKLIGHT
    depends on AIC_DISPLAY_DRV

    config AIC_PWM_BACKLIGHT
    bool "pwm"
    depends on AIC_PWM_DRV

    config AIC_GPIO_BACKLIGHT
    bool "gpio"
endchoice

if AIC_GPIO_BACKLIGHT
    config AIC_PANEL_ENABLE_GPIO
        string "panel backlight enable pin"
        default "PE.19"

    config AIC_PANEL_ENABLE_GPIO_LOW
        bool "panel backlight enable pin low active"
        default n
endif

if AIC_PWM_BACKLIGHT
    config AIC_PWM_BACKLIGHT_CHANNEL
        int "pwm backlight channel"
        default 3

    config AIC_PWM_BRIGHTNESS_LEVEL
        int "default brightness level"
        default 80
        range 0 100
endif

config AIC_PANEL_SPI_EMULATION
    bool
    default n
```

## bsp/artinchip/drv/display/Kconfig.lvds
```kconfig
#-----------------------------
# lvds devices local parameter
#-----------------------------

menu "LVDS interface options"
    depends on AIC_DISP_LVDS

choice
    prompt "lvds mode"
    default JEIDA_24BIT
    depends on AIC_DISP_LVDS

config AIC_LVDS_NS
    bool "vesa-24"

config AIC_LVDS_JEIDA_24BIT
    bool "jeida-24"

config AIC_LVDS_JEIDA_18BIT
    bool "jeida-18"
endchoice

config AIC_LVDS_MODE
    int
    default 0     if AIC_LVDS_NS
    default 1     if AIC_LVDS_JEIDA_24BIT
    default 2     if AIC_LVDS_JEIDA_18BIT

choice
    prompt "lvds link mode"
    default AIC_LVDS_LINK_1 if AIC_DE_DRV_V10
    default AIC_LVDS_LINK_0 if AIC_DE_DRV_V11
    depends on AIC_DISP_LVDS

config AIC_LVDS_LINK_0
    bool "single link 0"
    depends on AIC_DE_DRV_V10 || AIC_DE_DRV_V11

config AIC_LVDS_LINK_1
    bool "single link 1"
    depends on AIC_DE_DRV_V10

config AIC_LVDS_DOUBLE_SCREEN
    bool "double screen"
    depends on AIC_DE_DRV_V10

config AIC_LVDS_DUAL_LINK
    bool "dual link"
    depends on AIC_DE_DRV_V10
endchoice

config AIC_LVDS_LINK_MODE
    int
    default 0     if AIC_LVDS_LINK_0
    default 1     if AIC_LVDS_LINK_1
    default 2     if AIC_LVDS_DOUBLE_SCREEN
    default 3     if AIC_LVDS_DUAL_LINK

endmenu
```
