## bsp/artinchip/drv/i2c/Kconfig.dev
```kconfig
#-----------------------------
# i2c devices local parameter
#-----------------------------

# i2c0 parameter

menu "I2c0 Parameter"
    depends on AIC_USING_I2C0

    choice
        prompt "I2c0 Master && Slave "
        default AIC_DEV_I2C0_MASTER
        help
            Select i2c0 Master or Slave

        config AIC_DEV_I2C0_MASTER
            bool "Master"

        config AIC_DEV_I2C0_SLAVE
            bool "Slave"
    endchoice


endmenu

# i2c1 parameter

menu "I2c1 Parameter"
    depends on AIC_USING_I2C1

    choice
        prompt "I2c1 Master && Slave "
        default AIC_DEV_I2C1_MASTER
        help
            Select i2c1 Master or Slave

        config AIC_DEV_I2C1_MASTER
            bool "Master"

        config AIC_DEV_I2C1_SLAVE
            bool "Slave"
    endchoice

endmenu

# i2c2 parameter

menu "I2c2 Parameter"
    depends on AIC_USING_I2C2

    choice
        prompt "I2c2 Master && Slave "
        default AIC_DEV_I2C2_MASTER
        help
            Select i2c2 Master or Slave

        config AIC_DEV_I2C2_MASTER
            bool "Master"

        config AIC_DEV_I2C2_SLAVE
            bool "Slave"
    endchoice

endmenu

# i2c3 parameter

menu "I2c3 Parameter"
    depends on AIC_USING_I2C3

    choice
        prompt "I2c3 Master && Slave "
        default AIC_DEV_I2C3_MASTER
        help
            Select i2c3 Master or Slave

        config AIC_DEV_I2C3_MASTER
            bool "Master"

        config AIC_DEV_I2C3_SLAVE
            bool "Slave"
    endchoice

endmenu

menu "I2c4 Parameter"
    depends on AIC_USING_I2C4

    choice
        prompt "I2c4 Master && Slave "
        default AIC_DEV_I2C4_MASTER
        help
            Select i2c4 Master or Slave

        config AIC_DEV_I2C4_MASTER
            bool "Master"

        config AIC_DEV_I2C4_SLAVE
            bool "Slave"
    endchoice

endmenu

menu "SP_I2c Parameter"
    depends on AIC_USING_SP_I2C

    choice
        prompt "SP_I2c Master && Slave "
        default AIC_DEV_SP_I2C_MASTER
        help
            Select sp_i2c Master or Slave

        config AIC_DEV_SP_I2C_MASTER
            bool "Master"

        config AIC_DEV_SP_I2C_SLAVE
            bool "Slave"
    endchoice

endmenu

# common parameter
```

## bsp/artinchip/drv/pm/Kconfig
```kconfig
#-----------------------------
# devices local parameter
#-----------------------------

menu "PM configure"
    depends on AIC_USING_PM

    config AIC_PM_POWER_KEY
        bool "Enable gpio to sleep/wakeup system"
        default n

    config AIC_PM_POWER_KEY_GPIO
        string "Select sleep/wakeup pin"
        default "PD.6"
        depends on AIC_PM_POWER_KEY

    config AIC_PM_POWER_TOUCH_WAKEUP
        bool "Enable touch panel to wakeup system"
        default n

    config AIC_PM_POWER_TOUCH_TIME_SLEEP
        int "Seconds to enter sleep"
        default 120
        depends on AIC_PM_POWER_TOUCH_WAKEUP

    choice
        prompt "Select default sleep mode"
        default AIC_PM_POWER_DEFAULT_LIGHT_MODE

        config AIC_PM_POWER_DEFAULT_LIGHT_MODE
            bool "light sleep mode"

        config AIC_PM_POWER_DEFAULT_DEEP_MODE
            bool "deep sleep mode"
    endchoice

endmenu
```

## bsp/artinchip/drv/qspi/Kconfig.dev
```kconfig
#-----------------------------
# qspi devices local parameter
#-----------------------------

menu "Qspi0 Parameter"
    depends on AIC_USING_QSPI0

    config AIC_DEV_QSPI0_MAX_SRC_FREQ_HZ
        int "Max frequency(Hz)"
        default 100000000

endmenu

menu "Qspi1 Parameter"
    depends on AIC_USING_QSPI1

    config AIC_DEV_QSPI1_MAX_SRC_FREQ_HZ
        int "Max frequency(Hz)"
        default 100000000

endmenu

menu "Qspi2 Parameter"
    depends on AIC_USING_QSPI2

    config AIC_DEV_QSPI2_MAX_SRC_FREQ_HZ
        int "Max frequency(Hz)"
        default 100000000

endmenu

menu "Qspi3 Parameter"
    depends on AIC_USING_QSPI3

    config AIC_DEV_QSPI3_MAX_SRC_FREQ_HZ
        int "Max frequency(Hz)"
        default 100000000

endmenu

menu "Se spi Parameter"
    depends on AIC_USING_SE_SPI

    config AIC_DEV_SE_SPI_MAX_SRC_FREQ_HZ
        int "Max frequency(Hz)"
        default 50000000

endmenu

config AIC_SUPPORT_SPI_IN_BIT_MODE
    bool "Enable SPI bit mode"
    default n
    depends on AIC_QSPI_DRV

config AIC_SUPPORT_SPI_X_WIRE_IN_BIT_MODE
    int "SPI bit mode is 3-WIRE or STD"
    depends on AIC_SUPPORT_SPI_IN_BIT_MODE
    default 3
    range 3 4

source "bsp/artinchip/drv/spinor/Kconfig.dev"
source "bsp/artinchip/drv/spinand/Kconfig.dev"
```

## bsp/artinchip/drv/rtc/Kconfig
```kconfig
#-----------------------------
# RTC devices local parameter
#-----------------------------

menu "RTC Parameter"
    depends on AIC_USING_RTC

    config AIC_RTC_CLK_RATE
        int "The actual rate of 32K clock"
        default 3276800

    config AIC_RTC_ALARM_IO_OUTPUT
        bool "Enable the alarm IO output"
        default n

    config AIC_RTC_32K_IO_OUTPUT
        bool "Enable the 32K clock output"
        default n
endmenu
```

## bsp/artinchip/drv/sdmc/Kconfig
```kconfig
#-----------------------------
# SDMC devices local parameter
#-----------------------------

config AIC_SDMC_IRQ_MODE
    bool "Enable the interrupt of SDMC"
    default n
    depends on AIC_USING_SDMC0 || AIC_USING_SDMC1 || AIC_USING_SDMC2

# SDMC0 parameter

menu "SDMC0 Parameter"
    depends on AIC_USING_SDMC0

choice
    prompt "Select SDMC0 BUSWIDTH"
    default AIC_SDMC0_BUSWIDTH4
    config AIC_SDMC0_BUSWIDTH1
        bool "sdmc 1-bit mode"
    config AIC_SDMC0_BUSWIDTH4
        bool "sdmc 4-bit mode"
    config AIC_SDMC0_BUSWIDTH8
        bool "sdmc 8-bit mode"
endchoice

    config AIC_SDMC0_DRV_PHASE
        int "SDMC0 driver phase"
        range 0 3
        default 3

    config AIC_SDMC0_SMP_PHASE
        int "SDMC0 sample phase"
        range 0 3
        default 0

endmenu

# SDMC1 parameter

menu "SDMC1 Parameter"
    depends on AIC_USING_SDMC1

choice
    prompt "Select SDMC1 BUSWIDTH"
    default AIC_SDMC1_BUSWIDTH4
    config AIC_SDMC1_BUSWIDTH1
        bool "sdmc 1-bit mode"
    config AIC_SDMC1_BUSWIDTH4
        bool "sdmc 4-bit mode"
endchoice

    config AIC_SD_USING_HOTPLUG
        bool "Using SDcard hotplug detection"
        default n

    config AIC_SDMC1_IS_SDIO
        bool "SDMC1 connect to a SDIO device"
        select AIC_SDMC_IRQ_MODE
        default n

    config AIC_SDMC1_DRV_PHASE
        int "SDMC1 driver phase"
        range 0 3
        default 3

    config AIC_SDMC1_SMP_PHASE
        int "SDMC1 sample phase"
        range 0 3
        default 0

endmenu

# SDMC2 parameter

menu "SDMC2 Parameter"
    depends on AIC_USING_SDMC2

choice
    prompt "Select SDMC2 BUSWIDTH"
    default AIC_SDMC2_BUSWIDTH4
    config AIC_SDMC2_BUSWIDTH1
        bool "sdmc 1-bit mode"
    config AIC_SDMC2_BUSWIDTH4
        bool "sdmc 4-bit mode"
endchoice

    config AIC_SDMC2_IS_SDIO
        bool "SDMC2 connect to a SDIO device"
        select AIC_SDMC_IRQ_MODE
        default n

    config AIC_SDMC2_DRV_PHASE
        int "SDMC2 driver phase"
        range 0 3
        default 3

    config AIC_SDMC2_SMP_PHASE
        int "SDMC2 sample phase"
        range 0 3
        default 0

endmenu

# common parameter
```

## bsp/artinchip/drv/spienc/Kconfig
```kconfig
#-----------------------------
# devices local parameter
#-----------------------------

if AIC_USING_SPIENC

config AIC_SPIENC_QSPI0
    bool "Enc qspi0"
    default n
    select AIC_QSPI_DRV
    depends on AIC_USING_QSPI0

config AIC_SPIENC_QSPI0_TWEAK
    int "set qspi0 tweak"
    default 0
    depends on AIC_SPIENC_QSPI0

config AIC_SPIENC_QSPI1
    bool "Enc qspi1"
    default n
    select AIC_QSPI_DRV
    depends on AIC_USING_QSPI1

config AIC_SPIENC_QSPI1_TWEAK
    int "set qspi1 tweak"
    default 0
    depends on AIC_SPIENC_QSPI1

endif
```
