## Kconfig
```kconfig
mainmenu "ArtInChip Luban-Lite SDK Configuration"

menu "Project options"

config PRJ_DEFCONFIG_FILENAME
    string "Project defconfig file name"

comment "-- Important: If following options have been changed, you need save & rerun menuconfig before changing any other options."

config PRJ_CHIP
    string "Chip name"
    #option env="PRJ_CHIP"
    default "d21x"

config PRJ_BOARD
    string "Board name"
    #option env="PRJ_BOARD"
    default "fpga"

config PRJ_KERNEL
    string "Kernel name"
    #option env="PRJ_KERNEL"
    default "rt-thread"

config PRJ_APP
    string "Application name"
    #option env="PRJ_APP"
    default "helloworld"

endmenu

config PLATFORM_LUBANLITE
    bool
    default y

config PKGS_DIR
    string
    option env="PKGS_ROOT"
    default "packages"

if ! AIC_BOOTLOADER
source "application/Kconfig"
endif
#source "kernel/$PRJ_KERNEL/Kconfig"
#source "$PKGS_DIR/Kconfig"
source ".Kconfig.prj"
source "packages/Kconfig"
source "bsp/Kconfig"
```

## application/Kconfig
```kconfig
menu "Application options"

#============================================
# Filesystem related:
#============================================

comment "Filesystem related"

menuconfig AIC_USING_FS_IMAGE_0
    bool "Using File System Image 0"
    default n

if AIC_USING_FS_IMAGE_0
choice
    prompt "Select File System Type"
    default AIC_USING_FS_IMAGE_TYPE_LITTLEFS_FOR_0
    config AIC_USING_FS_IMAGE_TYPE_FATFS_FOR_0
        bool "FATFS"
    config AIC_USING_FS_IMAGE_TYPE_UFFS_FOR_0
        bool "UFFS"
    config AIC_USING_FS_IMAGE_TYPE_LITTLEFS_FOR_0
        bool "LittleFS"
endchoice

config AIC_FS_IMAGE_DIR_0
    string "Data Directory"
    default "packages/artinchip/lvgl-apps/base_demo/lvgl_src/"

config AIC_FS_IMAGE_NAME_0
    string "Image Name"
    default "app.lfs"

if AIC_USING_FS_IMAGE_TYPE_FATFS_FOR_0
config AIC_FATFS_AUTO_SIZE_FOR_0
    bool "auto calcuate image size"
    default y
config AIC_FATFS_SECTOR_SIZE_FOR_0
    int "sector size"
    depends on !AIC_FATFS_AUTO_SIZE_FOR_0
    default 512

config AIC_FATFS_SECTOR_COUNT_FOR_0
    int "sector count"
    depends on !AIC_FATFS_AUTO_SIZE_FOR_0
    default 2048

config AIC_FATFS_ENABLE_WRITE_IN_SPINOR
    bool "FATFS enable write func in spinor"
    depends on AIC_SPINOR_DRV
    default n
endif

# Parameters for LittleFS
if AIC_USING_FS_IMAGE_TYPE_LITTLEFS_FOR_0
config AIC_LITTLEFS_BLOCK_SIZE_FOR_0
    int "Erase block size"
    default 4096
config AIC_LITTLEFS_PAGE_SIZE_FOR_0
    int "Page size"
    default 256
endif

endif

menuconfig AIC_USING_FS_IMAGE_1
    bool "Using File System Image 1"
    default n

if AIC_USING_FS_IMAGE_1
choice
    prompt "Select File System Type"
    default AIC_USING_FS_IMAGE_TYPE_LITTLEFS_FOR_1
    config AIC_USING_FS_IMAGE_TYPE_FATFS_FOR_1
        bool "FATFS"
    config AIC_USING_FS_IMAGE_TYPE_UFFS_FOR_1
        bool "UFFS"
    config AIC_USING_FS_IMAGE_TYPE_LITTLEFS_FOR_1
        bool "LittleFS"
endchoice

config AIC_FS_IMAGE_DIR_1
    string "Data Directory"
    default "fs_user"

config AIC_FS_IMAGE_NAME_1
    string "Image Name"
    default "user"

if AIC_USING_FS_IMAGE_TYPE_FATFS_FOR_1
config AIC_FATFS_AUTO_SIZE_FOR_1
    bool "auto calcuate image size"
    default y
config AIC_FATFS_SECTOR_SIZE_FOR_1
    int "sector size"
    depends on !AIC_FATFS_AUTO_SIZE_FOR_1
    default 512

config AIC_FATFS_SECTOR_COUNT_FOR_1
    int "sector count"
    depends on !AIC_FATFS_AUTO_SIZE_FOR_1
    default 2048
endif

# Parameters for LittleFS
if AIC_USING_FS_IMAGE_TYPE_LITTLEFS_FOR_1
config AIC_LITTLEFS_BLOCK_SIZE_FOR_1
    int "Erase block size"
    default 4096
config AIC_LITTLEFS_PAGE_SIZE_FOR_1
    int "Page size"
    default 256
endif

endif

if AIC_USING_FS_IMAGE_TYPE_FATFS_FOR_0 || AIC_USING_FS_IMAGE_TYPE_FATFS_FOR_1
    config AIC_USING_FS_IMAGE_TYPE_FATFS_CLUSTER_SIZE
        int "size of cluster in fatfs image"
        default 8
endif

config GENERATE_BURNER_IMAGE
    bool "Generate burner format image"
    default n

comment "LVGL demo select related"

# Kconfig file for package LVGL
menuconfig LPKG_USING_LVGL
    bool "LVGL (official): powerful and easy-to-use embedded GUI library"
    default n

if LPKG_USING_LVGL

    config LPKG_LVGL_PATH
        string
        default "/packages/multimedia/LVGL/LVGL"

    config LPKG_LVGL_THREAD_PRIO
        int "Priority of LVGL thread"
        default 20

    config LPKG_LVGL_THREAD_STACK_SIZE
        int "Stack size of LVGL thread"
        default 4096

    config LPKG_LVGL_DISP_REFR_PERIOD
        int "Display refresh period (ms)"
        default 5 # official suggestion

    config LPKG_USING_LVGL_SQUARELINE
        bool "Support SquareLine Studio"
        default n

    config LPKG_LVGL_USING_EXAMPLES
        bool "Enable built-in examples"
        default n

    config LPKG_LVGL_USING_DEMOS
        bool "Enable built-in demos"
        default n

endif

menuconfig AIC_LVGL_DEMO
    tristate "ArtInChip LVGL demo"
    select LPKG_USING_LVGL
    default n

if AIC_LVGL_DEMO
choice
    prompt "select LVGL demo"
    default AIC_LVGL_BASE_DEMO
    depends on AIC_LVGL_DEMO

config AIC_LVGL_BASE_DEMO
    bool "LVGL demo with basic function"

config AIC_LVGL_METER_DEMO
    bool "LVGL demo of meter"

config AIC_LVGL_LAUNCHER_DEMO
    bool "LVGL launcher demo"

if KERNEL_BAREMETAL
    config AIC_LVGL_GIF_DEMO
        bool "LVGL gif demo"
endif

endchoice

config LV_COLOR_DEPTH
    int "LVGL color depth(32/16)"
    default 32
    depends on LPKG_USING_LVGL
config LV_CACHE_IMG_NUM
    int "LVGL image cached number"
    default 2
    depends on LPKG_USING_LVGL
# Parameters for LVGL meter demo
if AIC_LVGL_METER_DEMO
    config LV_METER_SIMPLE_POINT
        bool "LVGL meter demo use simple point"
        default n
endif
endif

config LVGL_STORAGE_PATH
    string "LVGL Resource Directory"
    default "/rodata/lvgl_data"
endmenu
```

## application/baremetal/bootloader/Kconfig
```kconfig
menu "Bootloader options"

config AIC_BOOTLOADER
    bool
    default y
    select AIC_CONSOLE_BARE_DRV
    select AIC_PRINTF_BARE_DRV
    select AIC_USING_UMM_HEAP

menu "Console"
    config AIC_BOOTLOADER_CONSOLE_UART
        int "Console UART ID"
        range 0 8
        default 0
endmenu

menu "Drivers"
    config AIC_BOOTLOADER_MMC_SUPPORT
        bool "MMC boot support"
        default n
        select AIC_SDMC_DRV_TEST

    config AIC_BOOTLOADER_SPINOR_SUPPORT
        bool "SPI NOR boot support"
        default y
        select AIC_SPINOR_DRV_TEST

    config AIC_BOOTLOADER_SPINAND_SUPPORT
        bool "SPI NAND boot support"
        default y
        select AIC_SPINAND_DRV_TEST

    config AIC_BOOTLOADER_PSRAM_EN
        bool "PSRAM support"
        default n
        select AIC_XSPI_DRV
        source bsp/artinchip/drv_bare/psram/Kconfig.dev

    config AIC_BOOTLOADER_AXICFG_SUPPORT
        bool "AXICFG support"
        default n
        select AIC_AXICFG_DRV
        source bsp/artinchip/hal/axicfg/Kconfig.dev

    config AIC_BOOT_USB_DRV
        bool "USB device driver support"
        default n

    config AIC_BOOT_USBH_DRV
        bool "USB Uost driver support"
        default n

    config AIC_BOOTLOADER_UDISK_SUPPORT
        bool "UDISK support"
        default n
        select AIC_BOOT_USBH_DRV

endmenu # "Drivers"

menu "Components"
    config AIC_BOOTLOADER_FATFS_SUPPORT
        bool "Fatfs for bootloader"
        default n

endmenu # "Components"

menu "Upgrading"
    config AICUPG_UART_ENABLE
        bool "Upgrading by UART"
        default n
        select AIC_UART_DRV

    config AICUPG_USB_ENABLE
        bool "Upgrading by USB"
        default y
        select AIC_BOOT_USB_DRV

    config AICUPG_USB_DMA_ENABLE
        bool "DMA enable for USB device"
        depends on AICUPG_USB_ENABLE
        default n

    config AICUPG_SDCARD_ENABLE
        bool "Upgrading by SD Card"
        default n
        select AIC_BOOTLOADER_MMC_SUPPORT
        select AIC_BOOTLOADER_FATFS_SUPPORT

    config AICUPG_SDCARD_CONTROLLER_ID
        int  "SDMC controller id for SD Card"
        default 1
        depends on AICUPG_SDCARD_ENABLE

    config AICUPG_UDISK_ENABLE
        bool "Upgrading by UDISK"
        default n
        select AIC_BOOTLOADER_UDISK_SUPPORT
        select AIC_BOOTLOADER_FATFS_SUPPORT

    config AICUPG_UDISK_VERSION3_SUPPORT
        bool  "Support USB 3.0 Udisk"
        default n
        depends on AICUPG_UDISK_ENABLE

    config AICUPG_USB_CONTROLLER_MAX_NUM
        int  "USB Host controller count"
        default 1
        depends on AICUPG_UDISK_ENABLE

    config AICUPG_MMC_ARTINCHIP
        bool "Write to MMC support"
        default y
        depends on AIC_BOOTLOADER_MMC_SUPPORT

    config AICUPG_NAND_ARTINCHIP
        bool "Write to NAND support"
        default y
        depends on AIC_BOOTLOADER_SPINAND_SUPPORT

    config AICUPG_NOR_ARTINCHIP
        bool "Write to NOR support"
        default y
        depends on AIC_BOOTLOADER_SPINOR_SUPPORT
endmenu # "Upgrading settings"

menu "Commands"
    config AIC_BOOTLOADER_CMD_NOR_BOOT
        bool "nor boot"
        default y
        depends on AIC_BOOTLOADER_SPINOR_SUPPORT

    config AIC_BOOTLOADER_CMD_XIP_BOOT
        bool "xip boot"
        default n
        depends on AIC_BOOTLOADER_SPINOR_SUPPORT

    config AIC_BOOTLOADER_CMD_NAND_BOOT
        bool "nand boot"
        default y
        depends on AIC_BOOTLOADER_SPINAND_SUPPORT

    config AIC_BOOTLOADER_CMD_MMC_BOOT
        bool "mmc boot"
        default n

    config AIC_BOOTLOADER_CMD_SPI_NOR
        bool "spinor"
        default y
        depends on AIC_BOOTLOADER_SPINOR_SUPPORT

    config AIC_BOOTLOADER_CMD_SPI_NAND
        bool "spinand"
        default y
        depends on AIC_BOOTLOADER_SPINAND_SUPPORT

    config AIC_BOOTLOADER_CMD_MTD
        bool "mtd read/write"
        default y
        depends on AIC_BOOTLOADER_SPINAND_SUPPORT || AIC_BOOTLOADER_SPINOR_SUPPORT
        select AIC_MTD_BARE_TEST

    config AIC_BOOTLOADER_CMD_MEM
        bool "mem"
        default y

    config AIC_BOOTLOADER_CMD_PART
        bool "part"
        default y

    config AIC_BOOTLOADER_CMD_PROGRESS_BAR
        bool "boot progress bar"
        default n

    config AIC_BOOTLOADER_CMD_PSRAM_TEST
        bool "psram memory test"
        depends on AIC_XSPI_DRV
        default n
endmenu # "Commands"

menu "Debug"
    config AICUPG_DEBUG
        bool "aicupg debug log"
        default n

    config AICUPG_UART_DEBUG
        bool "aicupg uart debug log"
        default n

    config AIC_SHOW_BOOT_TIME
        bool "show boot time"
        default n

endmenu # "Debug"

endmenu # "Bootloader options"
```
