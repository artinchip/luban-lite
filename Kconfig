## bsp/artinchip/drv/display/Kconfig.rgb
```kconfig
#-----------------------------
# rgb devices local parameter
#-----------------------------

menu "RGB interface options"
    depends on AIC_DISP_RGB

choice
    prompt "rgb mode"
    default PRGB
    depends on AIC_DISP_RGB

config PRGB_MODE
    bool "PRGB"

endchoice

config AIC_RGB_MODE
    int
    default 0 if PRGB_MODE

choice
    prompt "interface format"
    default AIC_PRGB_16BIT_LD if AIC_DISP_RGB_DRV_V10
    default AIC_PRGB_24BIT if AIC_DISP_RGB_DRV_V11
    depends on AIC_DISP_RGB

config AIC_PRGB_24BIT
    bool "PRGB 24 BIT"

config AIC_PRGB_18BIT_LD
    bool "PRGB 18 BIT LD"

config AIC_PRGB_18BIT_HD
    bool "PRGB 18 BIT HD"

config AIC_PRGB_16BIT_LD
    bool "PRGB 16 BIT LD"

config AIC_PRGB_16BIT_HD
    bool "PRGB 16 BIT HD"

endchoice

config AIC_RGB_FORMAT
    int
    default 0 if AIC_PRGB_24BIT
    default 1 if AIC_PRGB_18BIT_LD
    default 2 if AIC_PRGB_18BIT_HD
    default 3 if AIC_PRGB_16BIT_LD
    default 4 if AIC_PRGB_16BIT_HD

choice
    prompt "data order"
    default DATA_ORDER_RGB
    depends on AIC_DISP_RGB

config DATA_ORDER_RGB
    bool "RGB"

config DATA_ORDER_RBG
    bool "RBG"

config DATA_ORDER_BGR
    bool "BGR"

config DATA_ORDER_BRG
    bool "BRG"

config DATA_ORDER_GRB
    bool "GRB"

config DATA_ORDER_GBR
    bool "GBR"

endchoice

config AIC_RGB_DATA_ORDER
    hex
    default 0x02100210     if DATA_ORDER_RGB
    default 0x02010201     if DATA_ORDER_RBG
    default 0x00120012     if DATA_ORDER_BGR
    default 0x00210021     if DATA_ORDER_BRG
    default 0x01200120     if DATA_ORDER_GRB
    default 0x01020102     if DATA_ORDER_GBR

choice
    prompt "clock phase select"
    default DEGREE_0
    depends on AIC_DISP_RGB

config AIC_DEGREE_0
    bool "0 degree"

config AIC_DEGREE_90
    bool "90 degree"

config AIC_DEGREE_180
    bool "180 degree"

config AIC_DEGREE_270
    bool "270 degree"

endchoice

config AIC_RGB_CLK_CTL
   int
   default 0 if AIC_DEGREE_0
   default 1 if AIC_DEGREE_90
   default 2 if AIC_DEGREE_180
   default 3 if AIC_DEGREE_270

config RGB_DATA_MIRROT
    bool "data mirror"
    default y if AIC_DISP_RGB_DRV_V11

config AIC_RGB_DATA_MIRROR
    int
    default 0 if !RGB_DATA_MIRROT
    default 1 if RGB_DATA_MIRROT

endmenu
```

## bsp/artinchip/drv/display/panel/Kconfig
```kconfig
menu "Display Panels"

    choice
        prompt "ArtInChip Panel Drivers"
        default AIC_SIMPLE_PANEL

    config AIC_SIMPLE_PANEL
        bool "ArtInChip simple panel"
        depends on AIC_DISP_RGB || AIC_DISP_LVDS

    config AIC_PANEL_DSI_XM91080
        bool "ArtInChip MIPI DSI xm91080 panel"
        depends on AIC_DISP_MIPI_DSI

    config AIC_PANEL_DSI_ST7797
        bool "ArtInChip MIPI DSI st7797 panel"
        depends on AIC_DISP_MIPI_DSI

    config AIC_PANEL_DBI_ILI9488
        bool "ArtInChip MIPI DBI ili9488 panel"
        depends on AIC_DISP_MIPI_DBI

    config AIC_PANEL_DBI_ILI9341
        bool "ArtInChip MIPI DBI ili9341 panel"
        depends on AIC_DISP_MIPI_DBI

    config AIC_PANEL_DBI_ST77903
        bool "ArtInChip MIPI DBI st77903 panel"
        depends on AIC_DISP_MIPI_DBI

    config AIC_PANEL_DBI_ILI9486L
        bool "ArtInChip MIPI DBI ili9486l panel"
        depends on AIC_DISP_MIPI_DBI

    config AIC_PANEL_SRGB_HX8238
        bool "ArtInChip srgb hx8238 panel"
        depends on AIC_DISP_RGB
    endchoice

if AIC_SIMPLE_PANEL
source "bsp/artinchip/drv/display/panel/Kconfig.timing"
endif

endmenu
```

## bsp/artinchip/drv/display/panel/Kconfig.timing
```kconfig
menu "display timing of simple panel"

    config PANEL_PIXELCLOCK
        int "pixelclock in MHZ"
        default 52

    config PANEL_HACTIVE
        int "hactive"
        default 1024

    config PANEL_VACTIVE
        int "vactive"
        default 600

    config PANEL_HBP
        int "hback-porch"
    default 160

    config PANEL_HFP
        int "hfront-porch"
    default 160

    config PANEL_HSW
        int "hsync-len"
    default 20

    config PANEL_VBP
        int "vback-porch"
    default 12

    config PANEL_VFP
        int "vfront-porch"
    default 20

    config PANEL_VSW
        int "vsync-len"
    default 2
endmenu
```

## bsp/artinchip/drv/efuse/Kconfig.dev
```kconfig
#-----------------------------
# eFuse/SID devices local parameter
#-----------------------------
menu "SID Parameter"
    depends on AIC_USING_SID

    config EFUSE_MAX_WORD
	int "set efuse max word"
	default 64

    config EFUSE_TIMING_VALUE
	hex "set timing value"
	default 0x0402FFD8 if AIC_CHIP_D21X
	default 0x0402FFD8 if AIC_CHIP_D13X
	default 0x04021FF1 if AIC_CHIP_D12X
endmenu
```

## bsp/artinchip/drv/ge/Kconfig
```kconfig
#-----------------------------
# devices local parameter
#-----------------------------

menu "Graphics Engine Parameter"
depends on AIC_GE_DRV

choice
    prompt "Select Graphics Engine Mode"
    default AIC_GE_NORMAL
    depends on AIC_GE_DRV

config AIC_GE_CMDQ
    bool "CMD queue mode"
    help
      Enable CMA queue

config AIC_GE_NORMAL
    bool "normal mode"
    help
      Disable CMD Queue
endchoice

config AIC_GE_DITHER
    depends on AIC_GE_DRV
    bool "Dither function"
    default y
    help
        Turning off the Dither function can save memory about 16K bytes.

config AIC_GE_CMDQ_BUF_LENGTH
    depends on AIC_GE_CMDQ
    int "CMDQ queue buffer"
    range 1024 16384
    default 2048

config CTRL_GE_CLK_IN_FRAME
    bool "GE Clock Ctrl In Frames"
    default n
    help
      This is a GE Clock Ctrl in frames

endmenu
```
