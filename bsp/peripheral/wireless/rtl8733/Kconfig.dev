## packages/third-party/awtk/Kconfig
```kconfig
# Kconfig file for package AWTK
menuconfig LPKG_USING_AWTK
    bool "AWTK GUI"
    default n
    select RT_USING_CPLUSPLUS
    select RT_USING_CPLUSPLUS11

if LPKG_USING_AWTK

menu "AWTK function config"
    config WITH_G2D
        bool "Use g2d"
        default y
        select WITH_AIC_G2D

    config WITH_AIC_G2D
        depends on WITH_G2D
        bool "Use aic g2d"
        default y

    config WITH_DEC_IMAGE
        depends on WITH_G2D
        bool "Use decoding image"
        default n


    config APP_RES_ROOT
        depends on WITH_FS_RES
        string "Set app resource root"
        default "/data/res"

    choice
        prompt "Select lcd refresh mode"
        default WITH_LCD_FLUSH

    config WITH_LCD_SWAP
        bool "swap mode"

    config WITH_LCD_FLUSH
        bool "flush mode"
    endchoice

    choice
        prompt "Select bitmap format"
        default WITH_BITMAP_BGRA

    config WITH_BITMAP_BGR565
        bool "Bitmap bgh565 fotmat"

    config WITH_BITMAP_BGRA
        bool "Bitmap bgra8888 fotmat"
    endchoice

    config NDEBUG
        bool "Choice log level info else debug"
        default y

endmenu

menu "AWTK cropping config"
    config WITH_FS_RES
        bool "Use fatfs files system"
        default y

    config WITH_UNICODE_BREAK
        bool "Wrap using unicode standard"
        default y

    config WITH_STB_FONT
        bool "Support truetype fonts"
        default y

    config WITH_TEXT_BIDI
        bool "Supports bidirectional text alignment"
        default y

    config TK_GLYPH_CACHE_NR
        int "Font manager shrink cache num"
        default 256

    config TK_MAX_MEM_BLOCK_NR_ON
        bool "Support for multiple blocks of discontinuous memory"
        default n

    config TK_MAX_MEM_BLOCK_NR
        depends on TK_MAX_MEM_BLOCK_NR_ON
        int "Block nr num"
        default 4

    config WITH_IME_PINYIN
        bool "Use pinyin"
        default n

    config WITHOUT_SUGGEST_WORDS
        depends on WITH_IME_PINYIN
        bool "Use pinyin assiciate func"
        default n

    config WITH_MINI_FONT
        bool "Ues mini font"
        default n

    config WITH_DATA_READER_WRITER
        bool "The configuration file requires the use or data_reader/data_writer"
        default n

    config WITHOUT_WINDOW_ANIMATORS
        bool "Don't use window animations"
        default n

    config WITHOUT_WINDOW_ANIMATOR_CACHE
        bool "Don't use window animations cache"
        default n

    config WITHOUT_WIDGET_ANIMATORS
        bool "Don't use widget animations"
        default n

    config WITHOUT_CLIPBOARD
        bool "Don't use clip board"
        default n

    config WITHOUT_DIALOG_HIGHLIGHTER
        bool "Don't use dialog hightlighter"
        default n
endmenu

menu "AWTK thread config"
    config TK_UI_THREAD_STACK_SIZE
        int "UI thread stack size"
        default 60000

    config TK_UI_THREAD_PRIORITY
        int "UI thread prority"
        default 19

    config TK_UI_THREAD_TICK
        int "UI thread tick"
        default 20

    config TK_TOUCH_THREAD_STACK_SIZE
        int "Touch thread stack size"
        default 2048

    config TK_TOUCH_THREAD_PRIORITY
        int "Touch thread prority"
        default 19

    config TK_TOUCH_THREAD_TICK
        int "Touch thread tick"
        default 5

endmenu

menu "AWTK input device config"
    config AIC_TOUCH_PANEL_GT911
        bool "Using the input device gt911"
        default y
    config AIC_TOUCH_PANEL_GT911_NAME
        depends on AIC_TOUCH_PANEL_GT911
        string "The name of the input device is gt911"
        default "gt911"
    config AIC_TOUCH_PANEL_GT911_DEBUG
        depends on AIC_TOUCH_PANEL_GT911
        bool "The input device gt911 debug"
        default n
endmenu

choice
    prompt "Select a demo"
    default LPKG_AWTK_USING_DEMOS_CHART

config LPKG_AWTK_USING_DEMOS_CHART
        bool "Use demo chart"

config LPKG_AWTK_USING_OFFICIAL_DEMO
    bool "Use the official demo"

endchoice

endif
```

## packages/third-party/beep/Kconfig
```kconfig
# Kconfig file for package beep

menuconfig LPKG_USING_BEEP
    bool "beep: Control the buzzer to make beeps at different intervals."
    default n

if LPKG_USING_BEEP

    choice
        prompt "Buzzer type"
        default LPKG_BEEP_ACTIVE_BUZZER
        help
            Select the the Buzzer type

        config LPKG_BEEP_ACTIVE_BUZZER
            bool "Active buzzer"
            select RT_USING_PIN
            select BSP_USING_GPIO

        config LPKG_BEEP_PASSIVE_BUZZER
            bool "Passive buzzer"
            select RT_USING_PWM
            select BSP_USING_PWM
    endchoice

    if LPKG_BEEP_PASSIVE_BUZZER

        config LPKG_BEEP_PWM_DEV_NAME
            string "Setting current PWM device name."
            default "pwm1"

        config LPKG_BEEP_PWM_DEV_CHANNEL
            int "Setting current PWM device channel."
            range 1 4
            default 1

        config LPKG_BEEP_DEFAULT_FREQ
            int "Setting the best frequency(Hz) for buzzer."
            range 100 10000
            default 2700

        if RT_USING_PM
            config LPKG_BEEP_BLOCK_POWER_STOP
                bool "Block the MCU power enter to stop mode on beeping."
                default y

            config LPKG_BEEP_SUPPORT_PM_RUN_FREQ_CHANGE
                bool "Beep with the original frequency at MCU run frequency changed."
                default y
        endif

    endif

    config LPKG_BEEP_USING_MSH_CMD
    bool "Beep the buzzer on console to test."
    default n

    if RT_USING_HEAP
        config LPKG_BEEP_THREAD_STACK_USING_HEAP
        bool "Use heap with the beep thread stack created."
        default y
    endif
endif
```

## packages/third-party/benchmark/Kconfig
```kconfig
menu "BenchMark Tests"

config AIC_PRINT_FLOAT_CUSTOM
    bool
    default y
    depends on ARCH_RISCV32

source "packages/third-party/benchmark/coremark/Kconfig"
source "packages/third-party/benchmark/dhrystone/Kconfig"
source "packages/third-party/benchmark/stream/Kconfig"
source "packages/third-party/benchmark/whetstone/Kconfig"
source "packages/third-party/benchmark/linpack/Kconfig"

endmenu
```

## packages/third-party/benchmark/coremark/Kconfig
```kconfig
menuconfig LPKG_USING_COREMARK
    bool "COREMARK : a benchmark that measures the performance of MCUs and CPUs."
    default n

if LPKG_USING_COREMARK

    config COREMARK_USE_FLOAT
        select RT_USING_LIBC if RT_VER_NUM < 0x40100
        bool "Show benchmark result in float number"
        help
            Show benchmark result in float number.
        default n

    config COREMARK_ITERATIONS
        int "Run the benchmark for a specified number of iterations."
        default "36000"
    comment "You may ajust this number to make sure the benchmark runs for at least 10s"

    config CORE_MARK_HAS_FLOAT
        int
        default 1 if COREMARK_USE_FLOAT
        default 0
endif
```

## packages/third-party/benchmark/dhrystone/Kconfig
```kconfig
menuconfig LPKG_USING_DHRYSTONE
    bool "DHRYSTONE: a benchmark that measures the performance of MCUs and CPUs."
    default n

if LPKG_USING_DHRYSTONE

    config DHRY_ITERS
        int "Run the benchmark for a specified number of iterations."
        default "32000000"
    comment "You may ajust this number to make sure the benchmark runs long enough"

endif
```

## packages/third-party/benchmark/linpack/Kconfig
```kconfig
menuconfig LPKG_USING_LINPACK
    bool "LINPACK : a benchmark that measures the floating point computation performance."
    default n

if LPKG_USING_LINPACK

endif
```

## packages/third-party/benchmark/stream/Kconfig
```kconfig
menuconfig LPKG_USING_STREAM
    bool "STREAM : a benchmark that measures the sustained memory bandwidth."
    default n

if LPKG_USING_STREAM

    config STREAM_ARRAY_SIZE
        int "Stream test array size."
        default "200000"

endif
```

## packages/third-party/benchmark/whetstone/Kconfig
```kconfig
menuconfig LPKG_USING_WHETSTONE
    bool "WHETSTONE : a benchmark primarily measures the floating-point arithmetic performance."
    default n

if LPKG_USING_WHETSTONE

    config WHETSTONE_ITERATIONS
        int "Run the benchmark for a specified number of iterations."
        default "1000000"

endif
```

## packages/third-party/bonnie/Kconfig
```kconfig
config LPKG_USING_BONNIE
    bool "bonnie: File system benchmark"
    default n
    depends on RT_USING_FINSH && LPKG_USING_CPU_USAGE
```
