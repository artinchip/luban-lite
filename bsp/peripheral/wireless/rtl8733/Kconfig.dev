## packages/artinchip/env/Kconfig
```kconfig
menuconfig LPKG_USING_ENV
    bool "aic-env"
    default y

if LPKG_USING_ENV
config AIC_ENV_INTERFACE
    bool "Enable ENV interface and CMD"
    depends on LPKG_USING_ENV
    default n

config AIC_SYS_REDUNDAND_ENVIRONMENT
    bool "Enable redundant environment support"
    depends on AIC_ENV_INTERFACE
    default y

config AIC_ENV_PART_NAME
    string "Env part name"
    depends on AIC_ENV_INTERFACE
    default "env"

config AIC_ENV_REDUNDAND_PART_NAME
    string "Env redundant part name"
    depends on AIC_ENV_INTERFACE
    default "env_r"

config AIC_ENV_SIZE
    int "Environment Size"
    default 4096
    depends on AIC_ENV_INTERFACE

config AIC_ENV_DEBUG
    bool "Enable ENV debug"
    default n
    depends on AIC_ENV_INTERFACE

if AIC_BOOTLOADER
config AIC_AB_SYSTEM_INTERFACE
    bool "Enable A/B system support in bootloader"
    depends on AIC_ENV_INTERFACE
    default y
endif

if LPKG_USING_HTTP_OTA
config AIC_AB_SYSTEM_INTERFACE
    bool "Enable A/B system support"
    depends on AIC_ENV_INTERFACE
    default y
endif

endif
```

## packages/artinchip/mpp/Kconfig
```kconfig
menuconfig LPKG_MPP
    bool "aic-mpp"
    default y

config AIC_MPP_PLAYER_INTERFACE
    bool "Enable player interface and demo"
    default n
    depends on LPKG_MPP
    select LPKG_USING_MAD
    select AIC_AUDIO_DRV
    select RT_USING_PTHREADS

config AIC_MPP_VIN
    bool "Enable Video Input interface"
    default n
    depends on LPKG_MPP

config AIC_MPP_VIN_BUF_SIZE
    int "Size of Video Input buffer"
    default 1843264
    depends on AIC_MPP_VIN

config AIC_MPP_FB_TEST
    bool "Install MPP FB test programs"
    default n
    depends on LPKG_MPP
```

## packages/artinchip/pinmux-check/Kconfig
```kconfig
menuconfig LPKG_USING_PINMUX_CHECHK
    bool "aic-pinmux-check"
    default n

if LPKG_USING_PINMUX_CHECHK
config AIC_PINMUX_CHECK
    bool "Enable pinmux check tools"
    depends on LPKG_USING_PINMUX_CHECHK
    default n
endif
```

## packages/third-party/FreeRTOS-Wrapper/Kconfig
```kconfig
# Kconfig file for package FreeRTOS_Wrapper
menuconfig LPKG_USING_FREERTOS_WRAPPER
    bool "FreeRTOS Application Compatibility Layer for RT-Thread"
    default n

if LPKG_USING_FREERTOS_WRAPPER

    config LPKG_FREERTOS_WRAPPER_TEST
        bool "Include FreeRTOS_Wrapper test suit"
        default n

endif
```

## packages/third-party/Kconfig
```kconfig
menu "Third-party packages options"

source "packages/third-party/bonnie/Kconfig"
source "packages/third-party/cpu_usage/Kconfig"
source "packages/third-party/ramdisk/Kconfig"
source "packages/third-party/cherryusb/Kconfig"
source "packages/third-party/adbd/Kconfig"
source "packages/third-party/awtk-ui/Kconfig"
source "packages/third-party/lwip/Kconfig"
source "packages/third-party/uffs/Kconfig"
source "packages/third-party/littlefs/Kconfig"
source "packages/third-party/benchmark/Kconfig"
source "packages/third-party/FreeRTOS-Wrapper/Kconfig"
source "packages/third-party/i2c-tools/Kconfig"
source "packages/third-party/beep/Kconfig"
source "packages/third-party/memleak/Kconfig"
source "packages/third-party/webclient/Kconfig"
source "packages/third-party/ota_downloader/Kconfig"
source "packages/third-party/freetype/Kconfig"
source "packages/third-party/rtt_auto_exe_cmd/Kconfig"
source "packages/third-party/netutils/Kconfig"

# for baremetal mode
source "packages/third-party/dfs/Kconfig"
source "packages/third-party/libmad/Kconfig"
source "packages/third-party/fdtlib/Kconfig"

endmenu
```

## packages/third-party/adbd/Kconfig
```kconfig
# Kconfig file for package adbd
menuconfig LPKG_USING_ADBD
    bool "ADBD: Android Debug Bridge daemon implementation in RT-Thread"
    select RT_USING_DFS      if RT_VER_NUM < 0x40100
    select RT_USING_LIBC     if RT_VER_NUM < 0x40100
    select RT_USING_POSIX    if RT_VER_NUM < 0x40100
    select RT_USING_POSIX_FS if RT_VER_NUM >= 0x40100
    select RT_USING_POSIX_DEVIO if RT_VER_NUM >= 0x40100
    select RT_USING_POSIX_POLL if RT_VER_NUM >= 0x40100
    default n

if LPKG_USING_ADBD
    config LPKG_ADB_TR_TCPIP_ENABLE
        bool "Using TCPIP transfer"
        select RT_USING_SAL             if RT_VER_NUM < 0x40100
        select SAL_USING_POSIX          if RT_VER_NUM < 0x40100
        select RT_USING_POSIX_SOCKET    if RT_VER_NUM >= 0x40100
        default n
        depends on LPKG_USING_LWIP

    if LPKG_CHERRYUSB_DEVICE
        choice
            prompt "Select USB transfer mode"
            default LPKG_ADB_TR_CHERRYUSB_ENABLE
            config LPKG_ADB_TR_CHERRYUSB_ENABLE
                bool "Using Cherry USB transfer"
            config LPKG_ADB_TR_USB_ENABLE
                bool "Using RTT USB transfer"
        endchoice
    endif

    config LPKG_ADB_TR_STACK_SIZE
        int "Set transfer thread stack size"
        default 2048

    config LPKG_ADB_SERVICE_SHELL_ENABLE
        bool "Enable Shell service"
        default n
        select RT_USING_POSIX_STDIO

    config LPKG_ADB_SERVICE_FILE_ENABLE
        bool "Enable File service"
        default n

    if LPKG_ADB_SERVICE_FILE_ENABLE
        config LPKG_ADB_FILESYNC_STACK_SIZE
            int "Set file service thread stack size"
            default 3072

        config LPKG_ADB_FILESYNC_RECV_TIMEOUT
            int "Set file service receive timeout(ms)"
            default 2000
    endif

    config LPKG_ADB_EXTERNAL_MOD_ENABLE
            bool "Enable external MOD"
            default n

    if LPKG_ADB_EXTERNAL_MOD_ENABLE
        config LPKG_ADB_FILESYNC_MOD_ENABLE
            bool "Enable File SYNC Mod"
            select LPKG_ADB_SERVICE_FILE_ENABLE
            select LPKG_USING_CJSON
            select LPKG_USING_TINYCRYPT
            select TINY_CRYPT_MD5
            default n

        menuconfig LPKG_ADB_FILELIST_MOD_ENABLE
            bool "Enable File LIST Mod"
            select LPKG_ADB_SERVICE_FILE_ENABLE
            select LPKG_USING_CJSON
            default n

        if LPKG_ADB_FILELIST_MOD_ENABLE
            config LPKG_ADB_FILELIST_FULL_PATH
                bool "Using full path"
                default n

            config LPKG_ADB_FILELIST_SUP_MD5
                bool "Enable file MD5"
                select LPKG_USING_TINYCRYPT
                select TINY_CRYPT_MD5
                default n

            config LPKG_ADB_FILELIST_SUP_DEV
                bool "Enable Device ID"
                default n

            config LPKG_ADB_FILELIST_SUP_INO
                bool "Enable node info"
                default n

            config LPKG_ADB_FILELIST_SUP_MODE
                bool "Enable file type"
                default y

            config LPKG_ADB_FILELIST_SUP_NLINK
                bool "Enable link num"
                default n

            config LPKG_ADB_FILELIST_SUP_UID
                bool "Enable user ID"
                default n

            config LPKG_ADB_FILELIST_SUP_GID
                bool "Enable group ID"
                default n

            config LPKG_ADB_FILELIST_SUP_RDEV
                bool "Enable device type"
                default n

            config LPKG_ADB_FILELIST_SUP_SIZE
                bool "Enable file size"
                default y

            config LPKG_ADB_FILELIST_SUP_BLKSIZE
                bool "Enable block size"
                default n

            config LPKG_ADB_FILELIST_SUP_BLOCKS
                bool "Enable block num"
                default n

            config LPKG_ADB_FILELIST_SUP_ATIME
                bool "Enable access time"
                default n

            config LPKG_ADB_FILELIST_SUP_MTIME
                bool "Enable modify time"
                default n

            config LPKG_ADB_FILELIST_SUP_CTIME
                bool "Enable change time"
                default n
        endif
    endif

    config LPKG_ADB_USING_SSDP
        bool "Enable ADB service discovery"
        select LPKG_USING_LSSDP
        default n
endif
```

## packages/third-party/awtk-ui/Kconfig
```kconfig
# Kconfig file for package AWTK
menuconfig LPKG_USING_AWTK
    bool "AWTK GUI"
    default n
    select RT_USING_CPLUSPLUS
    select RT_USING_CPLUSPLUS11

if LPKG_USING_AWTK

menu "AWTK common function config"
    config WITH_G2D
        depends on AIC_USING_GE
        bool "Use g2d"
        default y
        select WITH_AIC_G2D

    config WITH_AIC_G2D
        depends on WITH_G2D
        bool "Use aic g2d"
        default y

    config WITH_DEC_IMAGE
        depends on WITH_G2D
        depends on AIC_USING_DE
        depends on WITH_FS_RES
        bool "Use decoding image"
        default y

    config APP_RES_ROOT
        depends on WITH_FS_RES
        string "Set app resource root"
        default "/rodata/res"

    config AWTK_START_UP
        bool "Self start funcion upon startup"
        default y

    choice
        prompt "Select lcd refresh mode"
        default WITH_LCD_SWAP_EX

    config WITH_LCD_FLUSH
        bool "flush mode"

    config WITH_LCD_SWAP
        bool "swap mode"

    config WITH_LCD_SWAP_EX
        bool "swap_ex mode"

    endchoice

endmenu

menu "AWTK cropping config"
    config WITH_FS_RES
        bool "Use files system"
        default y

    config WITH_STB_IMAGE
        depends on WITH_FS_RES
        bool "use STB image lib"
        default y

    config WITH_STB_FONT
        depends on WITH_STB_IMAGE
        bool "Support truetype fonts"
        default y

    config WITH_UNICODE_BREAK
        bool "Wrap using unicode standard"
        default y

    config WITHOUT_WINDOW_ANIMATOR_CACHE
        bool "Don't use window animation cache and default open don't use dialog hightlighter "
        default y

    choice
        prompt "Choice log level"
        default NDEBUG

    config WITH_DEBUG
        bool "log level debug"

    config NDEBUG
        bool "log level info"

    endchoice

    choice
        prompt "Select input method"
        default WITH_NULL_IM

    config WITH_IME_NULL
        bool "Supports soft keyboard without enabing input method"

    config WITH_NULL_IM
        bool "Don't supports soft keyboard without enabing input method"

    config WITH_IME_PINYIN
        bool "Use pinyin input method and soft keyboard"
    endchoice

    config WITHOUT_SUGGEST_WORDS
        depends on WITH_IME_PINYIN
        bool "Use pinyin assiciate func"
        default n

    config WITH_TEXT_BIDI
        bool "Supports bidirectional text alignment"
        default n

    config WITHOUT_WINDOW_ANIMATORS
        bool "Don't use window animation"
        default n

    config WITHOUT_WIDGET_ANIMATORS
        bool "Don't use widget animation"
        default n

    config WITHOUT_CLIPBOARD
        bool "Don't use clip board"
        default n

    config WITHOUT_DIALOG_HIGHLIGHTER
        bool "Don't use dialog hightlighter, ensure that windows animation is not in use"
        default n

    config WITHOUT_LAYOUT
        bool "Don't use layout algorithms"
        default n

    config WITHOUT_EXT_WIDGETS
        bool "Don't use ext widgets"
        default n

    config WITH_BITMAP_FONT
        bool "Supported pre decoded bitmap"
        help
            enabled when ram is extremly low
        default n

    config WITH_DATA_READER_WRITER
        bool "The configuration file requires the use or data_reader/data_writer"
        default n

    config WITH_ASSET_LOADER_ZIP
        depends on WITH_FS_RES
        bool "Use assets zip"
        default n

    config ASSETS_ZIP
        depends on WITH_ASSET_LOADER_ZIP
        string "Assets zip path"
        default "/rodata/assets.zip"

    config TK_GLYPH_CACHE_NR
        int "Font manager shrink cache num"
        default 64
endmenu

choice
    prompt "Select a demo"
    default LPKG_AWTK_USING_DEMOS_CHART

config LPKG_AWTK_USING_DEMOS_CHART
    bool "Use the chart demo"
    help
        "assets in packages/third-party/awtk-ui/user_apps/awtk-demo-chart/rtos_res/"

config LPKG_AWTK_USING_OFFICIAL_DEMO
    bool "Use the official demo"
    help
        "assets in packages/third-party/awtk-ui/user_apps/offical-demo/res/
endchoice

menu "AWTK thread config"
    config TK_UI_THREAD_STACK_SIZE
        int "UI thread stack size"
        default 10000

    config TK_UI_THREAD_PRIORITY
        int "UI thread prority"
        default 19

    config TK_UI_THREAD_TICK
        int "UI thread tick"
        default 20

    config TK_TOUCH_THREAD_STACK_SIZE
        int "Touch thread stack size"
        default 1536

    config TK_TOUCH_THREAD_PRIORITY
        int "Touch thread prority"
        default 19

    config TK_TOUCH_THREAD_TICK
        int "Touch thread tick"
        default 5

endmenu

menu "AWTK input device config"
    config AWTK_TOUCH_INPUT_DEV
        depends on AIC_TOUCH_PANEL_GT911
        bool "Using the input device gt911"
        default y

    config AIC_TOUCH_PANEL_GT911_NAME
        depends on AWTK_TOUCH_INPUT_DEV
        string "The name of the input device is gt911"
        default "gt911"

    config AIC_TOUCH_PANEL_GT911_DEBUG
        depends on AWTK_TOUCH_INPUT_DEV
        bool "The input device gt911 debug"
        default n
endmenu

endif
```
