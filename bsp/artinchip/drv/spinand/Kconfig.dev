## bsp/artinchip/drv/spinand/Kconfig.dev
```kconfig
#-----------------------------
# spinand local parameter
#-----------------------------

menuconfig AIC_QSPI0_DEVICE_SPINAND
    bool "QSPI0 Devices: SPINAND"
    depends on AIC_USING_QSPI0
    select LPKG_USING_SPINAND
    select AIC_SPINAND_DRV
    default n

if AIC_QSPI0_DEVICE_SPINAND
    config AIC_QSPI0_DEVICE_SPINAND_FREQ
        int "SPINAND bus frequency(Hz)"
	default 100000000

    config AIC_QSPI0_DEVICE_SPINAND_CONT_READ
        bool "Continuous Read Mode Enable"
	select AIC_SPINAND_CONT_READ
	default n
endif

menuconfig AIC_QSPI1_DEVICE_SPINAND
    bool "QSPI1 Devices: SPINAND"
    depends on AIC_USING_QSPI1
    select LPKG_USING_SPINAND
    select AIC_SPINAND_DRV
    default n

if AIC_QSPI1_DEVICE_SPINAND
    config AIC_QSPI1_DEVICE_SPINAND_FREQ
        int "SPINAND bus frequency(Hz)"
	default 100000000

    config AIC_QSPI0_DEVICE_SPINAND_CONT_READ
        bool "Continuous Read Mode Enable"
	select AIC_SPINAND_CONT_READ
	default n

endif

menuconfig AIC_QSPI2_DEVICE_SPINAND
    bool "QSPI2 Devices: SPINAND"
    depends on AIC_USING_QSPI2
    select LPKG_USING_SPINAND
    select AIC_SPINAND_DRV
    default n

if AIC_QSPI2_DEVICE_SPINAND
    config AIC_QSPI2_DEVICE_SPINAND_FREQ
        int "SPINAND bus frequency(Hz)"
	default 100000000

    config AIC_QSPI0_DEVICE_SPINAND_CONT_READ
        bool "Continuous Read Mode Enable"
	select AIC_SPINAND_CONT_READ
	default n

endif

menuconfig AIC_QSPI3_DEVICE_SPINAND
    bool "QSPI3 Devices: SPINAND"
    depends on AIC_USING_QSPI3
    select LPKG_USING_SPINAND
    select AIC_SPINAND_DRV
    default n

if AIC_QSPI3_DEVICE_SPINAND
    config AIC_QSPI3_DEVICE_SPINAND_FREQ
        int "SPINAND bus frequency(Hz)"
	default 100000000

    config AIC_QSPI0_DEVICE_SPINAND_CONT_READ
        bool "Continuous Read Mode Enable"
	select AIC_SPINAND_CONT_READ
	default n

endif
```

## bsp/artinchip/drv/spinand/Kconfig.drv
```kconfig
#-----------------------------
# qspi driver local parameter
#-----------------------------

config AIC_SPINAND_DRV
    bool
    select AIC_QSPI_DRV
    select RT_USING_MTD_NAND if DRIVER_DRV_EN
    default n


config AIC_SPINAND_CONT_READ
	bool
	default n
	help
	Enable this func for SPI NAND flash to speed up
	the start-up.if the device supports continuous read mode
	and the read length is greater then one page size,the device
	will enter the continuous read mode.this mode helps avoiding
	issuing a page read command and read from cache command again,
	and improves the performance of reading continuous pages.
```

## bsp/artinchip/drv/spinor/Kconfig.dev
```kconfig
#-----------------------------
# spinor driver local parameter
#-----------------------------

menuconfig AIC_QSPI0_DEVICE_SPINOR
    bool "QSPI0 Devices: SPINOR"
    depends on AIC_USING_QSPI0
    select AIC_SPINOR_DRV
    default n

if AIC_QSPI0_DEVICE_SPINOR
    config AIC_QSPI0_DEVICE_SPINOR_FREQ
        int "SPINOR bus frequency(Hz)"
	default 100000000

endif

menuconfig AIC_QSPI1_DEVICE_SPINOR
    bool "QSPI1 Devices: SPINOR"
    depends on AIC_USING_QSPI1
    default n

if AIC_QSPI1_DEVICE_SPINOR
    config AIC_QSPI1_DEVICE_SPINOR_FREQ
        int "SPINOR bus frequency(Hz)"
	default 100000000

endif

menuconfig AIC_QSPI2_DEVICE_SPINOR
    bool "QSPI2 Devices: SPINOR"
    depends on AIC_USING_QSPI2
    default n

if AIC_QSPI2_DEVICE_SPINOR
    config AIC_QSPI2_DEVICE_SPINOR_FREQ
        int "SPINOR bus frequency(Hz)"
	default 100000000

endif

menuconfig AIC_QSPI3_DEVICE_SPINOR
    bool "QSPI3 Devices: SPINOR"
    depends on AIC_USING_QSPI3
    default n

if AIC_QSPI3_DEVICE_SPINOR
    config AIC_QSPI3_DEVICE_SPINOR_FREQ
        int "SPINOR bus frequency(Hz)"
	default 100000000

endif

menuconfig AIC_SE_SPI_DEVICE_SPINOR
    bool "SE_SPI Devices: SPINOR"
    depends on AIC_USING_SE_SPI
    select AIC_SPINOR_DRV
    default n

if AIC_SE_SPI_DEVICE_SPINOR
    config AIC_SE_SPI_DEVICE_SPINOR_FREQ
        int "SPINOR bus frequency(Hz)"
	default 50000000

endif
```

## bsp/artinchip/drv/spinor/Kconfig.drv
```kconfig
#-----------------------------
# spinor driver local parameter
#-----------------------------

config AIC_SPINOR_DRV
    bool
    select AIC_QSPI_DRV
    select RT_USING_MTD_NOR if DRIVER_DRV_EN
    select RT_USING_SFUD if DRIVER_DRV_EN
    default n
```

## bsp/artinchip/drv/syscfg/Kconfig.dev
```kconfig
#-----------------------------
# syscfg local parameter
#-----------------------------

# syscfg parameter

menu "Syscfg Parameter"
    depends on AIC_USING_SYSCFG

        menuconfig AIC_SYSCFG_SIP_FLASH_ENABLE
            bool "SiP Flash Enable"
	    default n

	if AIC_SYSCFG_SIP_FLASH_ENABLE
		config AIC_SIP_FLASH_ACCESS_QSPI_ID
		    int "QSPI controller used by SiP Flash"
		    range 0 1
		    default 0
	endif

	menuconfig AIC_SYSCFG_LDO1X_ENABLE
		bool "SYSCFG LDO1X enable"
		default n
		if AIC_SYSCFG_LDO1X_ENABLE
			config AIC_SYSCFG_LDO1X_VOL_VAL
				depends on AIC_SYSCFG_DRV_V11
				int "LDO1X voltage value level <0-15>"
				default 6
				help
				    LDO1X_VAL_0_90V = 0,
					LDO1X_VAL_0_95V = 1,
					LDO1X_VAL_1_00V = 2,
					LDO1X_VAL_1_05V = 3,
					LDO1X_VAL_1_10V = 4,
					LDO1X_VAL_1_15V = 5,
					LDO1X_VAL_1_20V = 6,
					LDO1X_VAL_1_25V = 7,
					LDO1X_VAL_1_30V = 8,
					LDO1X_VAL_1_35V = 9,
					LDO1X_VAL_1_40V = 10,
					LDO1X_VAL_1_50V = 11,
					LDO1X_VAL_1_60V = 12,
					LDO1X_VAL_1_70V = 13,
					LDO1X_VAL_1_80V = 14,
					LDO1X_VAL_1_90V = 15
			config AIC_SYSCFG_LDO1X_VOL_VAL
				depends on AIC_SYSCFG_DRV_V12
				int "LDO1X voltage value level <0-15>"
				default 6
				help
					LDO1X_VAL_1_000V = 0,
					LDO1X_VAL_1_025V = 1,
					LDO1X_VAL_1_050V = 2,
					LDO1X_VAL_1_075V = 3,
					LDO1X_VAL_1_100V = 4,
					LDO1X_VAL_1_125V = 5,
					LDO1X_VAL_1_150V = 6,
					LDO1X_VAL_1_175V = 7,
					LDO1X_VAL_1_200V = 8,
					LDO1X_VAL_1_225V = 9,
					LDO1X_VAL_1_250V = 10,
					LDO1X_VAL_1_275V = 11,
					LDO1X_VAL_1_300V = 12,
					LDO1X_VAL_1_325V = 13,
					LDO1X_VAL_1_350V = 14,
					LDO1X_VAL_1_375V = 15

		endif
endmenu
```
