## bsp/peripheral/nftl/Kconfig
```kconfig
config AIC_NFTL_SUPPORT
        bool "Aic NFTL support"
        default n

    config AIC_NFLT_USED_LIB
        depends on AIC_NFTL_SUPPORT
        bool "Aic NFTL use lib"
        default n
```

## bsp/peripheral/spinand/Kconfig
```kconfig
# Kconfig file for package spinand
config LPKG_USING_SPINAND
    bool "SPINAND Driver library"
    default n

if LPKG_USING_SPINAND
config SPI_NAND_DOSILICON
	bool "Support Dosilicon SPI NAND"
    default n
	help
        Enable this driver for Dosilicon SPI NAND flash.

config SPI_NAND_ETRON
	bool "Support Etron SPI NAND"
    default n
	help
        Enable this driver for Etron SPI NAND flash.

config SPI_NAND_MICRON
	bool "Support Micron SPI NAND"
    default n
	help
        Enable this driver for Micron SPI NAND flash.

config SPI_NAND_MACRONIX
    bool "Support Macronix SPI NAND"
    default n
    help
        Enable this driver for Macronix SPI NAND flash.

config SPI_NAND_WINBOND
    bool "Support Winbond SPI NAND"
    default y
    help
        Enable this driver for Winbond SPI NAND flash.

config SPI_NAND_GIGADEVICE
    bool "Support GigaDevice SPI NAND"
    default n
    help
        Enable this driver for GigaDevice SPI NAND flash.

config SPI_NAND_TOSHIBA
    bool "Support Toshiba SPI NAND"
    default n
    help
        Enable this driver for Toshiba/Kioxia SPI NAND flash.

config SPI_NAND_FORESEE
    bool "Support Foresee SPI NAND"
    default n
    help
        Enable this driver for Foresee SPI NAND flash.

config SPI_NAND_XTX
    bool "Support Xtx SPI NAND"
    default n
    help
        Enable this driver for Xtx SPI NAND flash.

config SPI_NAND_ZETTA
    bool "Support Zetta SPI NAND"
    default n
    help
        Enable this driver for Zetta SPI NAND flash.

config SPI_NAND_ZBIT
	bool "Support Zbit SPI NAND"
	default n
	help
	  Enable this driver for Zbit SPI NAND flash.

config SPI_NAND_ESMT
	bool "Support ESMT SPI NAND"
	default n
	help
	  Enable this driver for ESMT SPI NAND flash.

config SPI_NAND_UMTEK
	bool "Support UMTEK SPI NAND"
	default n
	help
	  Enable this driver for UnitedMemory SPI NAND flash.

config SPI_NAND_QUANXING
	bool "Support QUANXING SPI NAND"
	default n
	help
	  Enable this driver for QUANXING SPI NAND flash.
endif
```

## bsp/peripheral/spinor_sfud/Kconfig
```kconfig
# Kconfig file for package ramdisk
config LPKG_USING_SFUD
    bool "SPINOR Driver SFUD: Serial Flash Universal Driver"
    default n
    help
        An using JEDEC's SFDP standard serial (SPI) flash universal driver library

# only for bootloader, rtos use RT_SFUD_USING_FLASH_INFO_TABLE
if LPKG_USING_SFUD && AIC_BOOTLOADER
    config BOOTLOADER_SFUD_USING_FLASH_INFO_TABLE
        bool "Using defined supported flash chip information table"
        default y
endif
```

## bsp/peripheral/touch/ft7411/Kconfig
```kconfig
menu "Ft7411 touch panel options"

config AIC_TOUCH_PANEL_FT7411
    bool "Using touch panel ft7411"
    default n
    select AIC_I2C_DRV

config AIC_TOUCH_PANEL_FT7411_I2C_CHA
    string "ft7411 using i2c channel index"
    default "i2c3"
    depends on AIC_TOUCH_PANEL_FT7411

config AIC_TOUCH_PANEL_FT7411_RST_PIN
    string "ft7411 reset pin"
    default "PA.8"
    depends on AIC_TOUCH_PANEL_FT7411

config AIC_TOUCH_PANEL_FT7411_INT_PIN
    string "ft7411 irq pin"
    default "PA.9"
    depends on AIC_TOUCH_PANEL_FT7411

config AIC_TOUCH_PANEL_FT7411_X_RANGE
    int "ft7411 x coordinate range"
    default 480
    depends on AIC_TOUCH_PANEL_FT7411

config AIC_TOUCH_PANEL_FT7411_Y_RANGE
    int "ft7411 y coordinate range"
    default 800
    depends on AIC_TOUCH_PANEL_FT7411

endmenu
```

## bsp/peripheral/touch/gsl1680/Kconfig
```kconfig
menu "GSL1680 touch panel options"

config AIC_TOUCH_PANEL_GSL1680
    bool "Using touch panel gsl1680"
    default n
    select AIC_I2C_DRV

config AIC_TOUCH_PANEL_GSL1680_I2C_CHA
    string "gsl1680 using i2c channel index"
    default "i2c2"
    depends on AIC_TOUCH_PANEL_GSL1680

config AIC_TOUCH_PANEL_GSL1680_RST_PIN
    string "gsl1680 reset pin"
    default "PA.10"
    depends on AIC_TOUCH_PANEL_GSL1680

config AIC_TOUCH_PANEL_GSL1680_INT_PIN
    string "gsl1680 irq pin"
    default "PA.11"
    depends on AIC_TOUCH_PANEL_GSL1680

config AIC_TOUCH_PANEL_GSL1680_X_RANGE
    int "gsl1680 x coordinate range"
    default 480
    depends on AIC_TOUCH_PANEL_GSL1680

config AIC_TOUCH_PANEL_GSL1680_Y_RANGE
    int "gsl1680 y coordinate range"
    default 272
    depends on AIC_TOUCH_PANEL_GSL1680

endmenu
```

## bsp/peripheral/touch/gt911/Kconfig
```kconfig
menu "Gt911 touch panel options"

config AIC_TOUCH_PANEL_GT911
    bool "Using touch panel gt911"
    default n
    select AIC_I2C_DRV

config AIC_TOUCH_PANEL_GT911_I2C_CHA
    string "gt911 using i2c channel index"
    default "i2c3"
    depends on AIC_TOUCH_PANEL_GT911

config AIC_TOUCH_PANEL_GT911_RST_PIN
    string "gt911 reset pin"
    default "PA.8"
    depends on AIC_TOUCH_PANEL_GT911

config AIC_TOUCH_PANEL_GT911_INT_PIN
    string "gt911 irq pin"
    default "PA.9"
    depends on AIC_TOUCH_PANEL_GT911

endmenu
```

## bsp/peripheral/touch/rtp/Kconfig
```kconfig
menu "RTP touch panel options"

config AIC_USING_RTP
    bool "Using touch panel RTP"
    default n
    select AIC_RTP_DRV

config AIC_RTP_PERIOD_MS
    int "The sample period of RTP(in cycle mode)"
    default 15
    depends on AIC_USING_RTP

config AIC_RTP_MAX_PRESSURE
    int "The pressure threshold of RTP"
    default 800
    depends on AIC_USING_RTP

config AIC_RTP_X_PLATE
    int "The x-plate value of RTP touchscreen"
    range 0 1024
    default 235
    depends on AIC_USING_RTP

config AIC_RTP_Y_PLATE
    int "The Y-plate value of RTP touchscreen"
    range 0 1024
    default 0
    depends on AIC_USING_RTP

config AIC_RTP_PDEB
    hex "The press detect enable debounce"
    range 0 0xffffffff
    default 0xffffffff
    depends on AIC_USING_RTP

config AIC_RTP_DELAY
    hex "The precharge delay of RTP"
    range 0 0xffffffff
    default 0x4f00004f
    depends on AIC_USING_RTP

endmenu
```

## bsp/peripheral/wireless/Kconfig
```kconfig
menuconfig AIC_WLAN_REALTEK
    bool "Using Realtek wlan driver"
    default n
    depends on AIC_WIRELESS_LAN
    select RT_USING_TIMER_SOFT
    select AIC_USING_REALTEK_WLAN0

    if AIC_WLAN_REALTEK
    source "bsp/peripheral/wireless/realtek/Kconfig"
    endif
```

## bsp/peripheral/wireless/realtek/Kconfig
```kconfig
#-----------------------------
# realtek wlan devices local parameter
#-----------------------------

# wlan0 parameter

config AIC_USING_REALTEK_WLAN0
    bool
    default n

config REALTEK_WLAN_INTF_SDIO
    bool
    default n

config REALTEK_WLAN_INTF_USB
    bool
    default n

choice
    prompt "Select realtek wlan0 modul"
    default AIC_USING_RTL8733_WLAN0
    config AIC_USING_RTL8733_WLAN0
        bool "rtl8733"
        select REALTEK_WLAN_INTF_SDIO

    config AIC_USING_RTL8189_WLAN0
        bool "rtl8189"
        select REALTEK_WLAN_INTF_SDIO
endchoice

menu "realtek wlan Parameter"

    config AIC_DEV_REALTEK_WLAN0_PWR_GPIO
        string "realtek wlan0 power on gpio"

    config AIC_DEV_REALTEK_WLAN0_IPADDR
        string "wlan0 ip addr"
        default "192.168.1.200"

    config AIC_DEV_REALTEK_WLAN0_GW
        string "wlan0 gateway addr"
        default "192.168.1.1"

    config AIC_DEV_REALTEK_WLAN0_NETMASK
        string "wlan0 netmask"
        default "255.255.255.0"

endmenu
```

## bsp/peripheral/wireless/rtl8733/Kconfig
```kconfig
config RTL8733_WLAN_DRV
    bool
    default n

config RTL8733_WLAN_INTF_SDIO
    bool
    default n

config RTL8733_WLAN_INTF_USB
    bool
    default n
```
